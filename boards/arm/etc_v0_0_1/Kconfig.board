## boards/arm/etc_v0_0_1/Kconfig.board
```kconfig
config BOARD_ETC_V0_0_1
	bool "ETC Core v0.0.1 with nRF52833 and BG95x"
	select HAS_DTS_GPIO
	depends on SOC_NRF52833_QIAA
```

## boards/arm/etc_v0_0_1/Kconfig.defconfig
```kconfig
if BOARD_ETC_V0_0_1

config BOARD
	default "ETC Core v0.0.1 with nRF52833 and BG95x"

config BT_CTLR
	default BT

endif # BOARD_ETC_V0_0_1
```

## boards/arm/etc_v0_2/Kconfig.board
```kconfig
config BOARD_ETC_V0_2
	bool "ETC Core with nRF52840 and BG95x"
	select HAS_DTS_GPIO
	depends on SOC_NRF52840_QIAA
```

## boards/arm/etc_v0_2/Kconfig.defconfig
```kconfig
if BOARD_ETC_V0_2

config BOARD
	default "ETC Core v0.2 with nRF52840 and BG95x"

config BOARD_VERSION
	string
	default "0.2.0"

config BT_CTLR
	default BT

endif # BOARD_ETC
```

## drivers/Kconfig
```kconfig
rsource "modem/Kconfig"
rsource "lora/Kconfig"
rsource "sensor/bq24195/Kconfig"
rsource "sensor/bq25618/Kconfig"
rsource "sensor/onewire/Kconfig"
rsource "sensor/max31888/Kconfig"
rsource "sensor/tmp1826/Kconfig"
rsource "sensor/tmp1075/Kconfig"
rsource "sensor/sht31/Kconfig"
rsource "io/Kconfig"
rsource "rtc/pcf85263/Kconfig"
rsource "onewire_i2c/Kconfig"
rsource "w1/Kconfig"
```

## drivers/bq24195/Kconfig
```kconfig
menuconfig BQ24195
	bool "BQ24195 Power Management Integrated Circuits (PMIC)"
	depends on I2C
	help
	  Enable I2C-based driver for BQ24195 PMIC.

if BQ24195

module = BQ24195
module-str = BQ24195
source "${ZEPHYR_BASE}/subsys/logging/Kconfig.template.log_config"

endif # BQ24195
```

## drivers/datetime/Kconfig
```kconfig
menuconfig DATE_TIME
	bool "Date time library"
	default y
	select POSIX_CLOCK
	
if DATE_TIME

config DATE_TIME_UPDATE_INTERVAL_SECONDS
	int "Date time update interval, in seconds"
	default 3600
	help
		Setting this option to 0 disables sequential date time updates.

config DATE_TIME_THREAD_SIZE
	int "Stack size of the thread maintaining date time"
	default 1024

endif # DATE_TIME
```

## drivers/ds18b20/Kconfig
```kconfig
menuconfig DS18B20
	bool "DS18B20 Temperature Sensor"
	help
	  Enable driver for the DS18B20 temperature sensor family.

if DS18B20

module = DS18B20
module-str = DS18B20
source "${ZEPHYR_BASE}/subsys/logging/Kconfig.template.log_config"

endif
```

## drivers/ds18s20/Kconfig
```kconfig
menuconfig DS18S20
	bool "DS18S20 Temperature and Humidity Sensor"
	depends on DS2484
	help
	  Enable driver for the DS18S20 temperature and humidity sensor family.

if DS18S20

config DS18S20_THREAD_STACK_SIZE
	int "Stack size for the DS18S20"
	default 1028
	help
	  This stack is used by the quectel BG9X RX thread.

module = DS18S20
module-str = DS18S20
source "${ZEPHYR_BASE}/subsys/logging/Kconfig.template.log_config"

endif
```

## drivers/io/Kconfig
```kconfig
config ETC_IO
	bool "ETC GPIO Driver"
	depends on GPIO
	help
	  Enable driver for GPIO

if ETC_IO

module = ETC_IO
module-str = ETC_IO
source "${ZEPHYR_BASE}/subsys/logging/Kconfig.template.log_config"

endif
```

## drivers/lora/Kconfig
```kconfig
config LORA_SX1276
	bool "Enable Lora SX1276"
	select LORA_SX127X
	help
	  Choose this setting to enable semtech, sx1276
```

## drivers/modem/Kconfig
```kconfig
config MODEM_QUECTEL_BG95_M3
	bool "Enable quectel modem driver"
	select MODEM_CONTEXT
	select MODEM_CMD_HANDLER
	select MODEM_IFACE_UART
	select MODEM_SOCKET
	select NET_OFFLOAD
	select NET_SOCKETS_OFFLOAD
	help
	  Choose this setting to enable quectel BG95-M3 customized LTE-CatM1/NB-IoT modem
	  driver.

config MODEM_QUECTEL_BG95_M3_MOCK
	bool "Enable mocking of Quectel BG95 M3"
	help
	  Choose this to enable BG95M3 mocking.

if MODEM_QUECTEL_BG95_M3

config MODEM_QUECTEL_BG95_M3_RX_STACK_SIZE
	int "Stack size for the quectel BG9X modem driver RX thread"
	default 1028
	help
	  This stack is used by the quectel BG9X RX thread.

config MODEM_QUECTEL_BG95_M3_RX_WORKQ_STACK_SIZE
	int "Stack size for the quectel BG9X modem driver work queue"
	default 2048
	help
	  This stack is used by the work queue to pass off net_pkt data
	  to the rest of the network stack, letting the rx thread continue
	  processing data.

config MODEM_QUECTEL_BG95_M3_APN
	string "APN for establishing network connection"
	default "internet"
	help
	  This setting is used to set the APN name for the network connection
	  context.  This value is specific to the network provider and may
	  need to be changed.

config MODEM_QUECTEL_BG95_M3_USERNAME
	string "Username for establishing network connection"
	default ""
	help
	  This setting is used to set the User name for the network connection
	  context.  This value is specific to the network provider and may
	  need to be changed.

config MODEM_QUECTEL_BG95_M3_PASSWORD
	string "Password for establishing network connection"
	default ""
	help
	  This setting is used to set the Password for the network connection
	  context.  This value is specific to the network provider and may
	  need to be changed.

config MODEM_QUECTEL_BG95_M3_SSL_NEGOTIATION_TIMEOUT
	int "SSL Negotiation Timeout in seconds"
	default 20
	help
	  The SSL negotiation timeout that the modem uses for every DTLS context.
	  The valid range is 10 to 300 seconds. The timeout is being set by the
	  driver through the AT+QSSLCFG="negotiatetime" command.

config MODEM_QUECTEL_BG95_M3_INIT_PRIORITY
	int "Quectel BG95 M3 driver init priority"
	default 95
	help
	  Quectel BG95 M3 device driver initialization priority.
	  Do not mess with it unless you know what you are doing.
	  Note that the priority needs to be lower than the net stack
	  so that it can start before the networking sub-system.

config MODEM_QUECTEL_BG95_M3_SIM_NUMBERS
	bool "Read IMSI and ICCID from modem"
	default y

config MODEM_QUECTEL_BG95_M3_DYNAMIC_PSK
	bool "Allow the use of non-static PSK credentials"
	default y

config MODEM_QUECTEL_BG95_M3_PSK_ID_MAX_SIZE
	int "Maximum size of the PSK identity"
	default 64

config MODEM_QUECTEL_BG95_M3_PSK_MAX_SIZE
	int "Maximum size of the PSK"
	default 64

config MODEM_QUECTEL_BG95_M3_PSK_ID
	string "PSK ID when using DTLS"
	default "EXACT"
	help
	  When using DTLS over UDP, the modem uses the PSK method to encrypt the
	  data. This option specifies the PSK ID to use.

config MODEM_QUECTEL_BG95_M3_PSK_KEY
	string "PSK Key in hex format when using DTLS"
	default "875ba79f213ecd8c"
	help
	  When using DTLS over UDP, the modem uses the PSK method to encrypt the
	  data. This option specifies the PSK key to use.

choice
	prompt "Select PSM functionality"
	default MODEM_QUECTEL_BG95_PSM

config MODEM_QUECTEL_BG95_PSM
	bool "Enable/disable PSM functionality"

config MODEM_QUECTEL_BG95_SOFT_PSM
	bool "Enable/disable software method for PSM functionality"

endchoice

config MODEM_QUECTEL_BG95_M3_PSM_REQ_RPTAU
	string "PSM setting requested periodic TAU"
	default "00111000"
	help
		Power saving mode setting for requested periodic TAU.
		See 3GPP 27.007 Ch. 7.38.
		And 3GPP 24.008 Ch. 10.5.7.4a for data format.

config MODEM_QUECTEL_BG95_M3_PSM_REQ_RAT
	string "PSM setting requested active time"
	default "00001010"
	help
		Power saving mode setting for requested active time.
		See 3GPP 27.007 Ch. 7.38.
		And 3GPP 24.008 Ch. 10.5.7.3 for data format.

config MODEM_NTP_SERVER
	string "NTP server to poll date/time"
	default "time.aws.com"
	help 
		The NTP server for getting date/time when the modem is online

config MODEM_SOFT_PSM_WAIT_TIME_SEC
	int "The timeout to put the modem to sleep mode like PSM"
	default 20
	
endif
```

## drivers/modem/Kconfig.gnss
```kconfig
if MODEM_QUECTEL_BG95_M3

config MODEM_QUECTEL_BG95_M3_GNSS
	bool "Enable BG95 GNSS functionality"

if MODEM_QUECTEL_BG95_M3_GNSS

config MODEM_QUECTEL_BG95_M3_GNSS_SHELL
	bool "Enable the BG95 GNSS shell"

endif # MODEM_QUECTEL_BG95_M3_GNSS

endif # MODEM_QUECTEL_BG95_M3
```

## drivers/onewire_i2c/Kconfig
```kconfig
menuconfig ONEWIRE_I2C
	bool "Bridge One-wire to I2C driver"
	depends on W1_NET
	depends on DT_HAS_MAXIM_DS28E18_ENABLED
	help
	  Enable driver for the DS28E18 the bridge One-wire to I2C protocol.

if ONEWIRE_I2C
	config ONEWIRE_I2C_INIT_PRIORITY
	int
	default 75
	help
		The priority for initialization for DS28E18 over One Wire
		
module = ONEWIRE_I2C
module-str = ONEWIRE_I2C
source "${ZEPHYR_BASE}/subsys/logging/Kconfig.template.log_config"
endif
```

## drivers/pcf85263/Kconfig
```kconfig
menuconfig PCF85263
	bool "PCF85263 RTC"
	select I2C
	select POLL
	help
	  Enable I2C-based driver for PCF85263 RTC.

if PCF85263
	config PCF85263_WATCHDOG_FEED_INTERNAL_SECONDS
		int "Watchdog feed interval time"
		depends on PCF85263
		default 60
		help
			PCF85263 watchdog feed internal time in seconds. Must less than 124s

module = PCF85263
module-str = PCF85263
source "${ZEPHYR_BASE}/subsys/logging/Kconfig.template.log_config"

endif
```

## drivers/retained_mem/Kconfig
```kconfig
config RETAINED_MEM_MOCK_RAM
	bool "Generic Zephyr RAM retained memory driver"
	depends on DT_HAS_ZEPHYR_RETAINED_RAM_ENABLED
	depends on RETAINED_MEM
	help
	  Enable driver for retained memory in mock RAM.
```

## drivers/sensor/bq24195/Kconfig
```kconfig
menuconfig BQ24195
	bool "BQ24195 Power Management Integrated Circuits (PMIC)"
	depends on I2C
	depends on DT_HAS_TI_BQ24195_ENABLED
	help
	  Enable I2C-based driver for BQ24195 PMIC.

if BQ24195

module = BQ24195
module-str = BQ24195
source "${ZEPHYR_BASE}/subsys/logging/Kconfig.template.log_config"

endif # BQ24195
```

## drivers/sensor/bq25618/Kconfig
```kconfig
menuconfig BQ25618
	bool "BQ25618 Power Management Integrated Circuits (PMIC)"
	depends on I2C
	depends on DT_HAS_TI_BQ25618_ENABLED
	help
	  Enable I2C-based driver for BQ25618 PMIC.

if BQ25618

module = BQ25618
module-str = BQ25618
source "${ZEPHYR_BASE}/subsys/logging/Kconfig.template.log_config"

endif # BQ25618
```

## drivers/sensor/max31888/Kconfig
```kconfig
# MAX31888 temperature sensor configuration options

# Copyright (c) 2023 EXACT Technology

config MAX31888
	bool "MAX31888 Temperature Sensor"
	default y
	depends on DT_HAS_MAXIM_MAX31888_ENABLED
	depends on W1_NET
	help
	  Enable driver for MAX31888 1-Wire temperature sensors.
```

## drivers/sensor/onewire/Kconfig
```kconfig
menuconfig DS2484
	bool "Bridge I2C to One-wire driver"
	select I2C
	select POLL
	help
	  Enable driver for the DS2484 the bridge I2C to One-wire protocol.

if DS2484

module = DS2484
module-str = DS2484
source "${ZEPHYR_BASE}/subsys/logging/Kconfig.template.log_config"
endif
```

## drivers/sensor/sht31/Kconfig
```kconfig
# SHT3xD temperature and humidity sensor configuration options

# Copyright (c) 2016 Intel Corporation
# SPDX-License-Identifier: Apache-2.0

menuconfig SHT31
	bool "SHT31 Temperature and Humidity Sensor"
	default y
	depends on DT_HAS_SENSIRION_SHT31_ENABLED
	select I2C
	select CRC
	help
	  Enable driver for SHT3xD temperature and humidity sensors.

if SHT31

choice SHT3XD_REPEATABILITY
	prompt "Measurement repeatability"
	default SHT3XD_REPEATABILITY_HIGH
	help
	  Repeatability modes differ with respect to measurement duration,
	  noise level and energy consumption.

config SHT3XD_REPEATABILITY_LOW
	bool "low"

config SHT3XD_REPEATABILITY_MEDIUM
	bool "medium"

config SHT3XD_REPEATABILITY_HIGH
	bool "high"

endchoice

choice SHT3XD_MPS
	prompt "Measurements per second"
	default SHT3XD_MPS_1
	depends on SHT3XD_PERIODIC_MODE
	help
	  Number of measurements per second.

config SHT3XD_MPS_05
	bool "0.5"

config SHT3XD_MPS_1
	bool "1"

config SHT3XD_MPS_2
	bool "2"

config SHT3XD_MPS_4
	bool "4"

config SHT3XD_MPS_10
	bool "10"

endchoice

endif # SHT31
```

## drivers/sensor/tmp1075/Kconfig
```kconfig
# TMP1075 temperature sensor configuration options
# Copyright (c) 2023 EXACT Technology
# SPDX-License-Identifier: Apache-2.0

menuconfig TMP1075
	bool "TMP1075 Temperature Sensor"
	depends on DT_HAS_TI_TMP1075_ENABLED
	depends on I2C

	help
	  Enable driver for the TMP108 temperature sensor

if TMP1075

module = TMP1075
module-str = TMP1075
source "${ZEPHYR_BASE}/subsys/logging/Kconfig.template.log_config"

endif # TMP1075
```

## drivers/sensor/tmp1826/Kconfig
```kconfig
# TMP1826 temperature sensor configuration options

# Copyright (c) 2023 EXACT Technology

config TMP1826
	bool "TMP1826 Temperature Sensor"
	default y
	depends on DT_HAS_TI_TMP1826_ENABLED
	depends on W1_NET
	help
	  Enable driver for TMP1826 1-Wire temperature sensors.
```

## drivers/w1/Kconfig
```kconfig
config EXACT_DS2484
	bool "DS2484 Single-Channel 1-Wire Master"
	select W1
	select I2C
	depends on DT_HAS_EXACT_DS2484_ENABLED
```
