## dts/bindings/counter/nxp,pcf85263a.yaml
```yaml
# Copyright (c) 2019, Foundries.io
# SPDX-License-Identifier: Apache-2.0

description: RTC SPI/I2C PCF85263

compatible: "nxp,pcf85263a"

include: i2c-device.yaml
```

## dts/bindings/i2c/maxim,ds28e18.yaml
```yaml
#
# Copyright (c) 2023 EXACT Technology
#

description:
    This is a representation of DS28E18 One-wire to I2C node

compatible: "maxim,ds28e18"

include: [i2c-controller.yaml, w1-slave.yaml]
```

## dts/bindings/io/etc,input.yaml
```yaml
description: ETC Input IO

compatible: "etc,input"

include: base.yaml

properties:
    status:
      required: true

    control-gpios:
      type: phandle-array
      required: true
      description: |
        GPIO input
```

## dts/bindings/io/etc,output.yaml
```yaml
description: ETC Output IO

compatible: "etc,output"

include: base.yaml

properties:
    status:
      required: true

    control-gpios:
      type: phandle-array
      required: true
      description: |
        GPIO output
```

## dts/bindings/modem/quectel,bg95.yaml
```yaml
# Copyright (c) 2020 Analog Life LLC
# SPDX-License-Identifier: Apache-2.0

description: quectel BG95 modem

compatible: "quectel,bg95"

include: uart-device.yaml

properties:
    mdm-on-off-gpios:
      type: phandle-array
      required: false

    mdm-power-gpios:
      type: phandle-array
      required: false
    
    mdm-pon-trig-gpios:
      type: phandle-array
      required: false

    mdm-psm-ind-gpios:
      type: phandle-array
      required: false

    mdm-uart-oe-gpios:
      type: phandle-array
      required: false

    mdm-reset-gpios:
      type: phandle-array
      required: false

    mdm-dtr-gpios:
      type: phandle-array
      required: false

    mdm-wdisable-gpios:
      type: phandle-array
      required: false

    cat-m-bands:
      type: array
      description: |
       Specify the LTE CAT-M1 bands to be used. The first element contains bands
       1 to 32, second element contains bands 33 to 64 and the third element
       contains bands 65 to 96. There MUST be values for all 3 elements. Specify
       0 if no band should be enabled.
       The values for bands are specified in dt-bindings/modem.h
      required: false

    nb-iot-bands:
      type: array
      description: |
       Specify the NB-IoT bands to be used. The first element contains bands
       1 to 32, second element contains bands 33 to 64 and the third element
       contains bands 65 to 96. There MUST be values for all 3 elements. Specify
       0 if no band should be enabled.
       The values for bands are specified in dt-bindings/modem.h
      required: false
```

## dts/bindings/sensor/maxim,max31888.yaml
```yaml
# Copyright (c) 2023, EXACT Technology

description: Maxim 1-Wire temperature sensor

compatible: "maxim,max31888"

include: [sensor-device.yaml, w1-slave.yaml]
```

## dts/bindings/sensor/sensirion,sht31.yaml
```yaml
# Copyright (c) 2018, Peter Bigot Consulting, LLC
# Copyright (c) 2023 EXACT Technology
# SPDX-License-Identifier: Apache-2.0

description: Sensirion Humidity SHT31 humidity and temperature sensor

compatible: "sensirion,sht31"

include: [sensor-device.yaml, i2c-device.yaml]
```

## dts/bindings/sensor/temp,ntc.yaml
```yaml
description: NTC thermistor sensor converter

compatible: "temp,ntc"

properties:
    b-value-k:
      type: int
      required: true
      description: Temperature charactersitics Norminal-B-Constant

    norminal-25c-ohms:
      type: int
      required: true
      description: Norminal 25oC resistor value in ohms

    reference-res-ohms:
      type: int
      required: true
      description: Reference resistor value in ohms
    
```

## dts/bindings/sensor/ti,bq25618.yaml
```yaml
description: Texas Instruments BQ25618/9 Singe Cell USB Charger

compatible: "ti,bq25618"

include: i2c-device.yaml

properties:
    max-current:
      type: int
      required: true
      description: Input current limit (mA)

    min-voltage:
      type: int
      required: true
      description: Minimum input voltage limit (mV)

    charge-current:
      type: int
      required: true
      description: Maximum current during fast charging (mA)

    precharge-current:
      type: int
      required: false
      description: The current during precharging (VBAT less than 3.0V) (mA)

    charge-voltage:
      type: int
      required: true
      description: Charging cut-off voltage (mV)
    
    has-charge-timer:
      type: boolean
      description: Enable the charging timer

    charge-timer-val:
      type: int
      default: 8
      description: Charging timer value (hours)

    int-gpios:
      type: phandle-array
      required: false
      description: |
        The INT signal defaults to active low open drain, so requires a
        pull-up on the board. It acts as an output and signals
        specific events happening (e.g. change in State of Charge).
```

## dts/bindings/sensor/ti,tmp1075.yaml
```yaml
# Copyright (c) 2023 EXACT Technology
# SPDX-License-Identifier: Apache-2.0

description: |
    TMP1075 Digital Temperature Sensor.  See more info at
    https://www.ti.com/product/TMP1075

compatible: "ti,tmp1075"

include: [sensor-device.yaml, i2c-device.yaml]

properties:
    alert-gpios:
      type: phandle-array
      description: |
        Identifies the ALERT signal, which is active-low open drain when
        produced by the sensor.
```

## dts/bindings/sensor/ti,tmp1826.yaml
```yaml
# Copyright (c) 2023, EXACT Technology

description: Maxim 1-Wire temperature sensor

compatible: "ti,tmp1826"

include: [sensor-device.yaml, w1-slave.yaml]

properties:
    resolution:
      type: int
      required: true
      description: |
          Resolution of the temperature reading in bit.
          Valid configurations are from 9 to 12 bits.
```

## dts/bindings/w1/exact,ds2484.yaml
```yaml
# Copyright (c) 2022 Caspar Friedrich <c.s.w.friedrich@gmail.com>
# SPDX-License-Identifier: Apache-2.0

description: Custom DS2484 Single-Channel 1-Wire Master

compatible: "exact,ds2484"

include: [i2c-device.yaml, w1-master.yaml]
```

## lib/Kconfig
```kconfig
menu "Libraries"
rsource "adc/Kconfig"
rsource "power/Kconfig"
rsource "sensor/ds18b20/Kconfig"
rsource "ui/Kconfig"
rsource "etc_lwm2m/Kconfig"
rsource "mcuboot_hook/Kconfig"
endmenu
```

## lib/adc/Kconfig
```kconfig
menuconfig ADC_MODULES
	bool "Configure for ADC module"
	depends on ADC
	help
	  Enable ADC Modules 

if ADC_MODULES

config ADC_MODULES_FILTER_SAMPLE_COUNT
	int "Number of samples that are taken when using adc_get_channel_filtered()"
	default 9

module = ADC_MODULES
module-str = ADC Modules
source "${ZEPHYR_BASE}/subsys/logging/Kconfig.template.log_config"

endif # ADC_MODULES
```

## lib/etc_lwm2m/Kconfig
```kconfig
#
# Copyright (c) 2023 EXACT Technology
#

menuconfig EXACT_LWM2M_CLIENT_UTILS
	bool "LWM2M client utilities library"
	select LWM2M if !ZTEST

if EXACT_LWM2M_CLIENT_UTILS

config EXACT_LWM2M_CLIENT_UTILS_SECURITY_OBJ_SUPPORT
	bool "Security object support"
	default y

config EXACT_LWM2M_CLIENT_UTILS_TLS_CID
	int "TLS context ID used on the modem for LwM2M"
	default 5

module = EXACT_LWM2M_CLIENT_UTILS
module-dep = LOG
module-str = EXACT LwM2M client utilities library
source "${ZEPHYR_BASE}/subsys/logging/Kconfig.template.log_config"

endif # EXACT_LWM2M_CLIENT_UTILS
```

## lib/mcuboot_hook/Kconfig
```kconfig
config ETC_MCUBOOT_ACTION_HOOK
        bool "Enable the ETC mcuboot action hook"
        depends on MCUBOOT_ACTION_HOOKS

if ETC_MCUBOOT_ACTION_HOOK

config MCUBOOT_PWM_FREQUENCY
	int "LED PWM frequency for mcuboot"
	range 100 1000000
	default UI_LED_PWM_FREQUENCY if UI_MODULE
	default 5000 if !UI_MODULE

endif
```

## lib/power/Kconfig
```kconfig
menuconfig POWER_MODULE
	bool "Enable Power module"
	select PM
	select PM_DEVICE
	default y
	help
		Enable the Power Management Module

if POWER_MODULE

config POWER_MODULE_RTC
	bool "Use RTC to control wakeup power"
	default y
	select COUNTER

config POWER_MODULE_RTC_NAME
	string "Power module device name for wakeup"
	default "RTC0"

config POWER_MODULE_SLEEP_TIME_SECOND
	int "Time for sleep"
	default 1800

module = POWER
module-str = Power
source "${ZEPHYR_BASE}/subsys/logging/Kconfig.template.log_config"

endif
```

## lib/sensor/ds18b20/Kconfig
```kconfig
menuconfig DS18B20_TIMER
	bool "DS18B20 Temperature Sensor"
	help
	  Enable driver for the DS18B20 temperature sensor family by using timer.

if DS18B20_TIMER

module = DS18B20_TIMER
module-str = DS18B20 TIMER
source "${ZEPHYR_BASE}/subsys/logging/Kconfig.template.log_config"

endif
```

## lib/ui/Kconfig
```kconfig
menuconfig UI_MODULE
	bool "Enable UI module"
	help
		Enable the User Interface module for user interaction

if UI_MODULE

config UI_LED_USE_PWM
	bool "Use PWM to control LEDs"
	default y
	select PWM

config UI_LED_PWM_DEV_NAME
	string "PWM device name for RGB LED"
	default "PWM_0"

config UI_LED_PWM_FREQUENCY
	int "LED PWM frequency"
	range 100 1000000
	default 5000

config UI_LED_RED_PIN
	int "Red LED pin number"
	default 13

config UI_LED_GREEN_PIN
	int "Green LED pin number"
	default 33

config UI_LED_BLUE_PIN
	int "Blue LED pin number"
	default 32

module = UI
module-str = User Interface
source "${ZEPHYR_BASE}/subsys/logging/Kconfig.template.log_config"

endif
```

## tests/applications/etc-app/always_on/testcase.yaml
```yaml
tests:
  # section.subsection
  tests.applications.etc-app.always_on:
    timeout: 600
    platform_allow:
      - native_sim
      - etc_flex/nrf52840
    integration_platforms:
      - native_sim
```

## tests/applications/etc-app/data_send_state/testcase.yaml
```yaml
tests:
  tests.applications.etc-app.data_send_state:
    platform_allow:
      - native_sim
    integration_platforms:
      - native_sim
```

## tests/applications/etc-app/etc_ble_adv_gate/testcase.yaml
```yaml
tests:
  tests.applications.etc-app.etc_ble_adv_gate:
    platform_allow:
      - native_sim
    integration_platforms:
      - native_sim
```

## tests/applications/etc-app/etc_calibration_session/testcase.yaml
```yaml
tests:
  tests.applications.etc-app.etc_calibration_session:
    platform_allow:
      - native_sim
    integration_platforms:
      - native_sim
```

## tests/applications/etc-app/etc_device/testcase.yaml
```yaml
tests:
  # section.subsection
  tests.applications.etc-app.etc_device_record:
    timeout: 600
    platform_allow:
      - native_sim
      - etc_flex/nrf52840
    integration_platforms:
      - native_sim
    platform_exclude:
      - etc
  tests.applications.etc-app.etc_device_record.cbor:
    timeout: 600
    platform_allow:
      - native_sim
      - etc_flex/nrf52840
    integration_platforms:
      - native_sim
    extra_configs:
      - CONFIG_ZCBOR=y
      - CONFIG_ZCBOR_CANONICAL=y
      - CONFIG_ETC_RECORD_CBOR=y
```

## tests/applications/etc-app/etc_device_helper/testcase.yaml
```yaml
tests:
  # section.subsection
  tests.applications.etc-app.etc_device_helper:
    timeout: 600
    platform_allow:
      - native_sim
      - etc_flex/nrf52840
    integration_platforms:
      - native_sim
    # platform_exclude:
    #   - etc
```
