## CMakeLists.txt
```
#SPDX - License - Identifier : Apache - 2.0

cmake_minimum_required(VERSION 3.20.0)
find_package(Zephyr REQUIRED HINTS $ENV{ZEPHYR_BASE})
project(etc_device_record_test)

FILE(GLOB app_sources src/*.c
                      src/mock/*.c
                      src/mock/cloud/cloud_codec/lwm2m/lwm2m_codec_helpers.c
                      src/mock/cloud/cloud_codec/lwm2m/lwm2m_codec.c
                      src/mock/zephyr/drivers/*.c)
target_sources(app PRIVATE ${app_sources})

set(APP_SRC_DIR ../../../../applications/etc-app/src)

target_sources(app PRIVATE 
                ${APP_SRC_DIR}/exact/etc_devices/etc_device.c
                ${APP_SRC_DIR}/exact/etc_devices/etc_device_record.c
                ${APP_SRC_DIR}/exact/etc_settings/etc_settings.c
                ${APP_SRC_DIR}/exact/etc_memfault/etc_memfault_dummy.c
                ${APP_SRC_DIR}/exact/etc_util/etc_util.c
)

target_compile_options(app PRIVATE -Wno-error=double-promotion)

target_include_directories(app PRIVATE
                            src
                            src/mock
                            src/mock/cloud/cloud_codec
                            src/mock/zephyr/drivers
                            ${APP_SRC_DIR}/exact/etc_devices
                            ${APP_SRC_DIR}/exact/etc_memfault
                            ${APP_SRC_DIR}/exact/etc_settings
                            ${APP_SRC_DIR}/exact/etc_sensor
                            ${APP_SRC_DIR}/exact/etc_util
                            ${APP_SRC_DIR}/exact/etc_calibration
                            ${APP_SRC_DIR})

zephyr_compile_definitions_ifdef(CONFIG_BOARD_NATIVE_SIM CONFIG_BOARD_VERSION="0.0.0")
zephyr_compile_definitions(CONFIG_LWM2M_SECURITY_KEY_SIZE=33)
zephyr_compile_definitions(CONFIG_SERIAL_NUMBER_TYPE=1)
zephyr_compile_definitions(CONFIG_SERIAL_NUMBER_DEFAULT_VALUE=10000000)
zephyr_compile_definitions(CONFIG_LWM2M_INTEGRATION_PSK="70475440693636213646256D7744")
zephyr_compile_definitions(CONFIG_MODEM_MODULE_GNSS_TIMEOUT_S=60)
zephyr_compile_definitions(CONFIG_ETC_APP_THRESHOLD_MIN_REPORT_INTERVAL_S=900)
zephyr_compile_definitions(CONFIG_MODEM_MODULE_MAX_CONNECTION_TIME_S=60)
zephyr_compile_definitions(IMAGE_HASH_LEN=32)
zephyr_compile_definitions(CONFIG_ETC_APP_LOG_LEVEL=3)
zephyr_compile_definitions(CONFIG_ETC_SETTINGS_LOG_LEVEL=3)
zephyr_compile_definitions(CONFIG_ETC_DEVICE_RELAY_MAX_RECORD_HISTORY=64)
zephyr_compile_definitions(CONFIG_ETC_DEVICE_SAVE_RECORD_SEC=1)
```

## prj.conf
```kconfig
CONFIG_ZTEST=y
CONFIG_HEAP_MEM_POOL_SIZE=8192
CONFIG_RETAINED_MEM=y

CONFIG_FLASH=y
CONFIG_FLASH_PAGE_LAYOUT=y
CONFIG_FLASH_MAP=y
CONFIG_NVS=y

# Settings - Used to store real-time device configuration to flash.
CONFIG_SETTINGS=y
CONFIG_SETTINGS_FCB=y
CONFIG_FCB=y

# CONFIG_POSIX=y

# Application Event Manager
CONFIG_APP_EVENT_MANAGER=y
CONFIG_APP_EVENT_MANAGER_LOG_EVENT_TYPE=n

CONFIG_TEST_RANDOM_GENERATOR=y
```

## src/main.c
```c
/*
 * Copyright (c) 2024 EXACT Technology Corporation
 */

#include <stdbool.h>
#include <string.h>
#include <zephyr/ztest.h>

#include "etc_device.h"
#include "etc_device_record.h"
#include "etc_settings.h"
#include "etc_util.h"
#include <zephyr/logging/log.h>
#include <zephyr/random/random.h>

LOG_MODULE_REGISTER(rx_timeout, CONFIG_ETC_APP_LOG_LEVEL);

static void *test_setup(void)
{
	etc_settings_init();
	return NULL;
}

ZTEST(rx_timeout_test, test_01_on_boot_up)
{
	zassert_equal(etc_get_device_mode(), ETC_SETTING_DEVICE_MODE_DEFAULT);
	zassert_equal(etc_get_rx_timeout_secs(), ETC_SETTING_RX_TIMEOUT_SECS_DEFAULT);
}

ZTEST_SUITE(rx_timeout_test, NULL, test_setup, NULL, NULL, NULL);
```

## src/compiler.h
```c
#ifndef _APP_COMPILER_H_
#define _APP_COMPILER_H_

#pragma GCC diagnostic ignored "-Wunused-function"
#pragma GCC diagnostic ignored "-Wunused-variable"

#endif /* _APP_COMPILER_H_ */
```
