## tests/applications/etc-app/etc_mlt_event/testcase.yaml
```yaml
tests:
  # section.subsection
  tests.applications.etc-app.etc_mlt_event:
    timeout: 600
    platform_allow:
      - native_sim
      - etc_flex/nrf52840
    integration_platforms:
      - native_sim
```

## tests/applications/etc-app/etc_sensor_calibration_load/testcase.yaml
```yaml
tests:
  tests.applications.etc-app.etc_sensor_calibration_load:
    platform_allow:
      - native_sim
    integration_platforms:
      - native_sim
```

## tests/applications/etc-app/etc_sensor_sim/testcase.yaml
```yaml
tests:
  tests.applications.etc-app.etc_sensor_sim:
    platform_allow:
      - native_sim
    integration_platforms:
      - native_sim
```

## tests/applications/etc-app/etc_sensor_splitter/testcase.yaml
```yaml
tests:
  tests.applications.etc-app.etc_sensor_splitter:
    platform_allow:
      - native_sim
    integration_platforms:
      - native_sim
```

## tests/applications/etc-app/functional_test/testcase.yaml
```yaml
tests:
  tests.applications.etc-app.functional_test:
    timeout: 120
    platform_allow:
      - native_sim
      - etc_flex/nrf52840
    integration_platforms:
      - native_sim
```

## tests/applications/etc-app/lwm2m_object/etc_reclaim/testcase.yaml
```yaml
tests:
  tests.applications.etc-app.lwm2m_object.etc_reclaim:
    platform_allow:
      - native_sim
    integration_platforms:
      - native_sim
```

## tests/applications/etc-app/lwm2m_object/etc_relay/testcase.yaml
```yaml
tests:
  tests.applications.etc-app.lwm2m_object.etc_relay:
    platform_allow:
      - native_sim
    integration_platforms:
      - native_sim
```

## tests/applications/etc-app/lwm2m_senml_cbor_basetime/testcase.yaml
```yaml
tests:
  tests.applications.etc-app.lwm2m_senml_cbor_basetime:
    platform_allow:
      - native_sim
    integration_platforms:
      - native_sim
    tags:
      - lwm2m
      - net
```

## tests/applications/etc-app/lwm2m_senml_cbor_float/testcase.yaml
```yaml
tests:
  tests.applications.etc-app.lwm2m_senml_cbor_float:
    platform_allow:
      - native_sim
    integration_platforms:
      - native_sim
    tags:
      - lwm2m
      - net
```

## tests/applications/etc-app/rx_timeout/testcase.yaml
```yaml
tests:
  # section.subsection
  tests.applications.etc-app.etc_always_on:
    timeout: 600
    platform_allow:
      - native_sim
      - etc_flex/nrf52840
    integration_platforms:
      - native_sim
```

## tests/applications/etc-app/signal_freshness/testcase.yaml
```yaml
tests:
  tests.applications.etc-app.signal_freshness:
    timeout: 120
    platform_allow:
      - native_sim
      - etc_flex/nrf52840
    integration_platforms:
      - native_sim
```

## tests/applications/etc-app/threshold_alert_state/testcase.yaml
```yaml
tests:
  tests.applications.etc-app.threshold_alert_state:
    platform_allow:
      - native_sim
    integration_platforms:
      - native_sim
```

## tests/applications/etc-app/threshold_eval/testcase.yaml
```yaml
tests:
  tests.applications.etc-app.threshold_eval:
    platform_allow:
      - native_sim
    integration_platforms:
      - native_sim
```

## tests/applications/etc-app/tx_interval/testcase.yaml
```yaml
tests:
  # section.subsection
  tests.applications.etc-app.etc_interval_time:
    timeout: 600
    platform_allow:
      - native_sim
      - etc_flex/nrf52840
    integration_platforms:
      - native_sim
```

## tests/applications/etc-app/upload_reason/testcase.yaml
```yaml
tests:
  # section.subsection
  tests.applications.etc-app.upload_reason:
    timeout: 600
    platform_allow:
      - native_sim
      - etc_flex/nrf52840
    integration_platforms:
      - native_sim
```

## tests/applications/etc-app/util/testcase.yaml
```yaml
tests:
  # section.subsection
  tests.applications.etc-app.util:
    build_only: false
    platform_allow:
      - native_sim
    integration_platforms:
      - native_sim
```

## west.yml
```yaml
manifest:
  self:
    path: etc-firmware

  remotes:
    - name: sdk-nrf
      url-base: https://github.com/nrfconnect
    - name: exact
      url-base: https://github.com/exact-technology
    - name: exact-ssh
      url-base: git@github.com:exact-technology

  projects:
    - name: nrf
      remote: sdk-nrf
      repo-path: sdk-nrf
      revision: v2.7.0
      import: true
    # list the Memfault SDK as a top-level module
    - name: memfault-firmware-sdk
      url: https://github.com/memfault/memfault-firmware-sdk
      path: modules/lib/memfault-firmware-sdk
      revision: 1.4.2
    - name: segger
      revision: globals_typedef
      path: modules/debug/segger
      remote: exact
    - name: etc-common-firmware
      remote: exact-ssh
      revision: 71526683a22454a80f3955592dd2f769a68bc18e
      path: modules/exact
```
