## CMakeLists.txt
```
#SPDX - License - Identifier : Apache - 2.0

cmake_minimum_required(VERSION 3.20.0)
find_package(Zephyr REQUIRED HINTS $ENV{ZEPHYR_BASE})
project(etc_device_record_test)

FILE(GLOB app_sources src/*.c
                      src/mock/*.c
                      src/mock/zephyr/drivers/*.c)
target_sources(app PRIVATE ${app_sources})

set(APP_SRC_DIR ../../../../applications/etc-app/src)

target_compile_options(app PRIVATE -Wno-error=double-promotion)

target_sources(app PRIVATE 
                ${APP_SRC_DIR}/exact/etc_devices/etc_device.c
                ${APP_SRC_DIR}/exact/etc_devices/etc_device_record.c
                ${APP_SRC_DIR}/exact/etc_devices/etc_device_helper.c
                ${APP_SRC_DIR}/exact/etc_devices/etc_relay_reclaim.c
                ${APP_SRC_DIR}/exact/etc_memfault/etc_memfault_dummy.c
                ${APP_SRC_DIR}/exact/etc_util/etc_util.c
                ${APP_SRC_DIR}/common.c
)

target_include_directories(app PRIVATE
                            src
                            src/mock
                            src/mock/zephyr/drivers
                            ${APP_SRC_DIR}/exact/etc_battery
                            ${APP_SRC_DIR}/exact/etc_devices
                            ${APP_SRC_DIR}/exact/etc_memfault
                            ${APP_SRC_DIR}/exact/etc_sensor
                            ${APP_SRC_DIR}/exact/etc_settings
                            ${APP_SRC_DIR}/exact/etc_util
                            ${APP_SRC_DIR}/exact/etc_calibration
                            ${APP_SRC_DIR})

zephyr_compile_definitions(IMAGE_HASH_LEN=32)
zephyr_compile_definitions(CONFIG_ETC_APP_LOG_LEVEL=3)
zephyr_compile_definitions(CONFIG_ETC_RELAY_RECLAIM_LOG_LEVEL=3)
zephyr_compile_definitions(CONFIG_ETC_DEVICE_RELAY_MAX_RECORD_HISTORY=64)
zephyr_compile_definitions(CONFIG_ETC_DEVICE_SAVE_RECORD_SEC=1)
```

## Kconfig
```
menu "Zephyr Kernel"
source "Kconfig.zephyr"
endmenu

config ETC_RECORD_CBOR
    bool "The new ETC format with structure encode/decode as CBOR"
    help
        Use the new data format.
```

## prj.conf
```kconfig
CONFIG_ZTEST=y
CONFIG_HEAP_MEM_POOL_SIZE=8192
CONFIG_RETAINED_MEM=y

CONFIG_FLASH=y
CONFIG_FLASH_PAGE_LAYOUT=y
CONFIG_FLASH_MAP=y
CONFIG_NVS=y

# Settings - Used to store real-time device configuration to flash.
CONFIG_SETTINGS=y
CONFIG_SETTINGS_FCB=y
CONFIG_FCB=y

CONFIG_POSIX_API=y

# Application Event Manager
CONFIG_APP_EVENT_MANAGER=y
CONFIG_APP_EVENT_MANAGER_LOG_EVENT_TYPE=n

CONFIG_REQUIRES_FLOAT_PRINTF=y
```

## boards/etc.conf
```kconfig
# Flash
CONFIG_SOC_FLASH_NRF_UICR=y
CONFIG_MPU_ALLOW_FLASH_WRITE=y

# Partition Manager
CONFIG_PM_SINGLE_IMAGE=y
CONFIG_PM_OVERRIDE_EXTERNAL_DRIVER_CHECK=y
CONFIG_PM_PARTITION_REGION_SETTINGS_STORAGE_EXTERNAL=n
CONFIG_PM_PARTITION_REGION_NVS_STORAGE_EXTERNAL=y

# segger RTT console
CONFIG_LOG_MODE_DEFERRED=y
CONFIG_USE_SEGGER_RTT=y
CONFIG_RTT_CONSOLE=n
CONFIG_LOG_BACKEND_RTT=y
CONFIG_LOG_MODE_MINIMAL=n
CONFIG_SHELL_LOG_BACKEND=n
CONFIG_SHELL_BACKEND_SERIAL=y

# Disable not needed devices
CONFIG_SHELL_BACKEND_SERIAL=n
CONFIG_CONSOLE=n
CONFIG_UART_CONSOLE=n
```

## src/main.c
```c
/*
 * Copyright (c) 2024 EXACT Technology Corporation
 */

#include <errno.h>
#include <stdbool.h>
#include <string.h>
#include <zephyr/ztest.h>
#include <math.h>
#include "etc_device.h"
#include "etc_device_record.h"
#include "etc_util.h"
#include <zephyr/drivers/retained_mem.h>
#include <zephyr/logging/log.h>
#include <zephyr/random/random.h>

LOG_MODULE_REGISTER(etc_device_record_test, CONFIG_ETC_APP_LOG_LEVEL);

#define FLOAT_TOLERANCE 0.5f

const static struct device *retained_ram_dev = DEVICE_DT_GET(DT_ALIAS(record_header_ram));
struct etc_device_record_table last_current_record;

#if CONFIG_BOARD_NATIVE_SIM
#define RECORD_ARRAY_SIZE (ETC_RECORD_MAX_RECORD)
#elif CONFIG_BOARD_ETC
#define RECORD_ARRAY_SIZE 6000
#else
#error "No support other SoC"
#endif

#if defined(CONFIG_ETC_RECORD_CBOR)
int8_t etc_sensor_get_probe_humid_index(void)
{
	return 5;
}
#endif

const struct sensor_data record_sample = {
	.timestamp = 1234567890,
	.battery_mV = 3800,
	.sensor = {12.1f, 87.1f, -6.2f, 32.6f, 0.2f, 0.3f, 0.3f, 0.3f, 0.3f, 99.9f},
	.battery_status = 1};

struct sensor_data records[RECORD_ARRAY_SIZE];

bool compare_sensor_records(const union etc_device_record *record, const struct sensor_data *sensor)
{
	bool is_equal = true;
	float sensor_battery_volts = sensor->battery_mV / 1000.0f;
	if (fabsf(sensor_battery_volts - record->battery) > FLOAT_TOLERANCE) {
		is_equal = false;
	}

	for (size_t i = 0; i < ETC_DEVICE_NUM_SENSOR; i++) {
		if (fabsf(sensor->sensor[i] - record->sensor[i]) > FLOAT_TOLERANCE) {
			LOG_ERR("Sensor %zu: %f != %f", i, sensor->sensor[i], record->sensor[i]);
			is_equal = false;
		}
	}

	if (sensor->timestamp != (int64_t)record->timestamp) {
		LOG_ERR("Sensor %zu: %f != %f", sensor->timestamp, record->timestamp);
		is_equal = false;
	}

	return is_equal;
}

static void *test_setup(void)
{
	int64_t index;
	etc_device_nvs_init();
	/* Make sure the record is fresh */
	etc_device_record_clean_up();
	etc_device_record_erase_record_flash();
	/* Populate records */
	for (int i = 0; i < ARRAY_SIZE(records); i++) {
		records[i].timestamp = record_sample.timestamp + i;
		records[i].battery_mV = record_sample.battery_mV;
		for (int j = 0; j < SENSOR_EVENT_NUM_DEV_MAX; j++) {
			records[i].sensor[j] = record_sample.sensor[j];
		}
		records[i].battery_status = 1;
	}

	return NULL;
}

static void test_teardown(void *)
{
	/* Allow ack/nack status to be saved to flash */
	k_sleep(K_SECONDS(CONFIG_ETC_DEVICE_SAVE_RECORD_SEC + 1));
}

static void on_write_num_records(uint16_t num_records, bool check_ack, bool check_index,
				 uint16_t index)
{
	int ret = 0;
	int last_ack = 0;
	int last_nack = 0;
	int total_record = etc_device_record_get_total_record();
	uint16_t last_newest_id = etc_device_record_get_latest_id();
	uint16_t last_oldest_id = etc_device_record_get_oldest_id();
	struct etc_device_record_table prev_status = {0};
	if (check_ack) {
		last_ack = etc_device_record_get_num_ack();
		last_nack = etc_device_nack_count();
		struct etc_device_record_table *status = etc_device_record_get_status();
		memcpy(&prev_status, status, sizeof(*status));
		zassert_equal(last_ack, total_record - last_nack, "ACK NOT OK %d %d", last_nack,
			      total_record - last_nack);
	}

	for (int i = 0; i < num_records; i++) {
		ret = etc_device_write_record_sensor(&records[i]);
		if (check_index && index == i) {
			/* This record should be next of last current record */
			struct etc_device_record_table *status = etc_device_record_get_status();
			struct etc_device_record_table *pre_status = &last_current_record;
			uint16_t next_of_pre_record_id =
				etc_device_get_next_id_by_index(&pre_status->newest);
			uint16_t current_id = etc_device_record_get_id_by_index(&status->newest);
			zassert_equal(next_of_pre_record_id, current_id, "ID -> NOT OK %d %d",
				      next_of_pre_record_id, current_id);
			if (check_ack) {
				/* Ignore current record. Only sync old records */
				total_record = etc_device_record_get_total_record();
				last_nack = etc_device_nack_count() - 1;
				last_ack = total_record - last_nack;
			}
		}
		zassert_ok(ret);
	}

	if (check_ack) {
		struct etc_device_record_table *status = etc_device_record_get_status();
		LOG_DBG("(%d,%d) - (%d,%d) %d %d", prev_status.newest.sector_idx,
			prev_status.newest.element_idx, prev_status.oldest.sector_idx,
			prev_status.oldest.element_idx, last_newest_id, last_oldest_id);
		uint16_t newest_id = etc_device_record_get_latest_id();
		uint16_t oldest_id = etc_device_record_get_oldest_id();
		LOG_DBG("(%d,%d) - (%d,%d) %d %d", status->newest.sector_idx,
			status->newest.element_idx, status->oldest.sector_idx,
			status->oldest.element_idx, newest_id, oldest_id);
		LOG_DBG("%d %d %d %d", total_record, num_records, last_ack, last_nack);
		uint16_t nack_count = 0;
		if (newest_id < last_newest_id) {
			nack_count = (newest_id + 1) + (MAX_RECORD_NO_OFFSET_ID + 1) -
				     (last_newest_id + 1);
		} else {
			if (last_newest_id == 0) {
				nack_count = newest_id + 1 - (last_newest_id);
			} else {
				nack_count = newest_id - last_newest_id;
			}
		}
		nack_count =
			(nack_count >= ETC_RECORD_MAX_RECORD) ? ETC_RECORD_MAX_RECORD : nack_count;

		total_record = etc_device_record_get_total_record();
		uint16_t ack_count = total_record - nack_count;
		last_ack = etc_device_record_get_num_ack();
		last_nack = etc_device_nack_count();
		LOG_DBG("%d %d %d %d %d", total_record, num_records, last_ack, last_nack,
			nack_count);
		zassert_equal(ack_count, last_ack, "ack count %d %d", ack_count, last_ack);
		zassert_equal(nack_count, last_nack, "nack_count: %d %d", ret, num_records);
	}
}

static void on_read_num_records(uint16_t num_records)
{
	int ret;
	int ack_count = etc_device_record_get_num_ack();
	int nack_count = etc_device_nack_count();
	bool reclaim = false;
	int record_id;
	union etc_device_record read_record;

	for (int i = num_records - 1; i >= 0; i--) {
		record_id = etc_device_read_record(&read_record, &reclaim);
		zassert(record_id > 0, "record id");
		ret = compare_sensor_records(&read_record, &records[i]);
		zassert_true(ret, "record %d %d", record_id, i);
		etc_device_set_ack_record(record_id);
		nack_count--;
		zassert_equal(nack_count, etc_device_nack_count());
		ack_count++;
		zassert_equal(ack_count, etc_device_record_get_num_ack(), "new_ack: %d",
			      etc_device_record_get_num_ack());
	}
}

static void on_save_record_status(void)
{
	struct etc_device_record_table *status = etc_device_record_get_status();
	/* Save last status before clear */
	memcpy(&last_current_record, status, sizeof(*status));
}

static void on_erase_ram(void)
{
	retained_mem_clear(retained_ram_dev);
}

static void on_save_flash(void)
{
	etc_device_record_save();
}

static void on_reinit_setting(void)
{
	etc_device_nvs_init();
}

ZTEST(etc_device_record_test, test_01_write_few_records)
{
	on_write_num_records(10, true, false, 0);
}

ZTEST(etc_device_record_test, test_02_read_few_records)
{
	on_read_num_records(10);
}

ZTEST(etc_device_record_test, test_03_write_full_records)
{
	on_write_num_records(ARRAY_SIZE(records), true, false, 0);
}

ZTEST(etc_device_record_test, test_04_read_full_records)
{
	on_read_num_records(ARRAY_SIZE(records));
}

ZTEST(etc_device_record_test, test_05_write_dummy_and_reset_ram)
{
	/* Force to re-init to apply RAM */
	on_save_flash();
	/* Write 10 records */
	on_write_num_records(10, false, false, 0);
	/* Backup record */
	on_save_record_status();
	/* Erase RAM */
	on_erase_ram();
	/* Reload RAM */
	on_reinit_setting();
}

ZTEST(etc_device_record_test, test_06_write_records_after_losing_ram)
{
	on_write_num_records(ARRAY_SIZE(records), true, true, 0);
}

ZTEST(etc_device_record_test, test_07_read_records_after_losing_ram)
{
	on_read_num_records(ARRAY_SIZE(records));
}

ZTEST(etc_device_record_test, test_08_repeat_test)
{
	for (int t = 0; t < 5; t++) {
		on_reinit_setting();
		on_write_num_records(ARRAY_SIZE(records), true, false, 0);
		on_read_num_records(ARRAY_SIZE(records));
		/* Force to re-init to apply RAM */
		on_save_flash();
		/* Write 10 records */
		on_write_num_records(5 * (t + 1), false, false, 0);
		/* Backup record */
		on_save_record_status();
		/* Erase RAM */
		on_erase_ram();
		/* Reinit RAM*/
		on_reinit_setting();
		on_write_num_records(ARRAY_SIZE(records), true, true, 0);
		on_read_num_records(ARRAY_SIZE(records));
	}
}

ZTEST(etc_device_record_test, test_09_repeat_rand)
{
	on_save_flash();
	on_reinit_setting();
	for (int t = 0; t < 25; t++) {
		uint16_t requests = rand() % RECORD_ARRAY_SIZE;
		on_write_num_records(requests, true, false, 0);
		on_read_num_records(requests);
	}
}

/*
 * FW-954: current (non-ack'd) readings must always take precedence over an
 * active reclaim. The helpers below build a store of historical, already-sent
 * (ACK'd) records, then a reclaim is scheduled over a sub-window of them while
 * fresh readings are injected.
 */
#define RECLAIM_HIST_COUNT 20 /* historical records to seed and ACK */
#define RECLAIM_WIN_START  5  /* reclaim window, by record offset (inclusive) */
#define RECLAIM_WIN_STOP   14

static int64_t reclaim_ts_offset(const union etc_device_record *rec)
{
	return (int64_t)rec->timestamp - (int64_t)record_sample.timestamp;
}

/* Read one record (NACK or reclaim), ACK it as the TX path would, and report
 * its timestamp offset and the reclaim-in-progress flag. Returns the record id.
 */
static int reclaim_read_one(int64_t *offset, bool *reclaim)
{
	union etc_device_record rec;
	bool r = false;
	int id = etc_device_read_record(&rec, &r);
	if (id > 0) {
		if (offset != NULL) {
			*offset = reclaim_ts_offset(&rec);
		}
		etc_device_set_ack_record(id);
	}
	if (reclaim != NULL) {
		*reclaim = r;
	}
	return id;
}

/* Reset to a clean store holding `count` historical records, all ACK'd. */
static void reclaim_seed_history(uint16_t count)
{
	etc_device_nvs_init();
	etc_device_record_clean_up();
	etc_device_record_erase_record_flash();

	for (uint16_t i = 0; i < count; i++) {
		zassert_ok(etc_device_write_record_sensor(&records[i]));
	}

	/* Drain and ACK everything so no NACK records remain. */
	while (reclaim_read_one(NULL, NULL) > 0) {
		/* keep draining */
	}
	zassert_equal(0, etc_device_nack_count(), "history not fully drained");
}

/* New readings queued before the reclaim starts serving must all be sent
 * before any reclaim record, and no readings may be lost.
 */
ZTEST(etc_device_record_test, test_10_new_readings_precede_reclaim)
{
	const int kNew = 6;
	const int new_base = RECLAIM_HIST_COUNT; /* offsets 20..25 */

	reclaim_seed_history(RECLAIM_HIST_COUNT);

	int rc = etc_device_record_reclaim(record_sample.timestamp + RECLAIM_WIN_START,
					   record_sample.timestamp + RECLAIM_WIN_STOP, false);
	zassert_true(rc >= 0, "reclaim schedule failed %d", rc);
	int win = etc_device_record_num_reclaim_records();
	zassert_true(win > 0, "no reclaim window scheduled");

	/* Fresh readings arrive while the reclaim is pending. */
	for (int i = 0; i < kNew; i++) {
		zassert_ok(etc_device_write_record_sensor(&records[new_base + i]));
	}

	bool seen_reclaim_record = false;
	int new_count = 0;
	int reclaim_count = 0;
	int64_t off;
	bool reclaim;

	while (reclaim_read_one(&off, &reclaim) > 0) {
		zassert_true(reclaim, "reclaim should stay in progress (offset %lld)", off);
		if (off >= new_base) {
			zassert_false(seen_reclaim_record,
				      "new reading %lld served after a reclaim record", off);
			new_count++;
		} else {
			zassert_true(off >= RECLAIM_WIN_START && off <= RECLAIM_WIN_STOP,
				     "unexpected record offset %lld", off);
			seen_reclaim_record = true;
			reclaim_count++;
		}
	}

	zassert_equal(kNew, new_count, "served new readings %d", new_count);
	zassert_equal(win, reclaim_count, "served reclaim records %d/%d", reclaim_count, win);
	zassert_equal(0, etc_device_nack_count(), "NACK remained after drain");

	/* The record that completes the reclaim still reports in-progress (the
	 * cloud sees SUCCESS on the following cycle); the next read confirms the
	 * reclaim is finished.
	 */
	zassert_true(reclaim_read_one(&off, &reclaim) <= 0, "store should be empty");
	zassert_false(reclaim, "reclaim should be inactive after completion");
}

/* A reading that arrives mid-reclaim must preempt the remaining reclaim
 * records, and the reclaim must resume and complete afterwards.
 */
ZTEST(etc_device_record_test, test_11_new_reading_preempts_active_reclaim)
{
	const int new_off = RECLAIM_HIST_COUNT; /* offset 20 */

	reclaim_seed_history(RECLAIM_HIST_COUNT);

	int rc = etc_device_record_reclaim(record_sample.timestamp + RECLAIM_WIN_START,
					   record_sample.timestamp + RECLAIM_WIN_STOP, false);
	zassert_true(rc >= 0, "reclaim schedule failed %d", rc);
	int win = etc_device_record_num_reclaim_records();
	zassert_true(win >= 2, "need a multi-record window, got %d", win);

	int64_t off;
	bool reclaim;

	/* No new data pending yet: the first record served is a reclaim record. */
	zassert_true(reclaim_read_one(&off, &reclaim) > 0, "expected a reclaim record");
	zassert_true(reclaim, "reclaim flag should be set");
	zassert_true(off >= RECLAIM_WIN_START && off <= RECLAIM_WIN_STOP,
		     "expected reclaim-window record, got %lld", off);
	int reclaim_count = 1;

	/* A fresh reading arrives in the middle of the reclaim... */
	zassert_ok(etc_device_write_record_sensor(&records[new_off]));

	/* ...and must be served before the rest of the reclaim window. */
	zassert_true(reclaim_read_one(&off, &reclaim) > 0, "expected the new reading");
	zassert_true(reclaim, "reclaim still in progress");
	zassert_equal(new_off, off, "new reading did not preempt reclaim (got %lld)", off);

	/* Drain the remainder: only reclaim-window records should follow. */
	int new_count = 1;
	while (reclaim_read_one(&off, &reclaim) > 0) {
		zassert_true(reclaim, "reclaim active until fully drained");
		if (off == new_off) {
			new_count++;
		} else {
			zassert_true(off >= RECLAIM_WIN_START && off <= RECLAIM_WIN_STOP,
				     "unexpected record offset %lld", off);
			reclaim_count++;
		}
	}

	zassert_equal(1, new_count, "new reading served exactly once");
	zassert_equal(win, reclaim_count, "all reclaim records served once (%d/%d)", reclaim_count,
		      win);
	zassert_equal(0, etc_device_nack_count(), "NACK remained after drain");

	zassert_true(reclaim_read_one(&off, &reclaim) <= 0, "store should be empty");
	zassert_false(reclaim, "reclaim should be inactive after completion");
}

/* FW-966: read-only existence check used by the LwM2M reclaim Execute handler to
 * decide whether any record falls within the requested period.
 */
ZTEST(etc_device_record_test, test_12_reclaim_available)
{
	const int64_t base = record_sample.timestamp;

	reclaim_seed_history(RECLAIM_HIST_COUNT); /* timestamps base+0 .. base+19 */

	/* Window covering seeded records -> available. */
	zassert_equal(1,
		      etc_device_record_reclaim_available(base + RECLAIM_WIN_START,
							  base + RECLAIM_WIN_STOP),
		      "records in window should be available");

	/* A single in-range instant (the oldest record). */
	zassert_equal(1, etc_device_record_reclaim_available(base, base),
		      "first record should be available");

	/* Window entirely before the seeded records -> none. */
	zassert_equal(0, etc_device_record_reclaim_available(base - 100, base - 1),
		      "window before records should be empty");

	/* Window entirely after the seeded records -> none. */
	zassert_equal(0,
		      etc_device_record_reclaim_available(base + RECLAIM_HIST_COUNT,
							  base + RECLAIM_HIST_COUNT + 100),
		      "window after records should be empty");

	/* Invalid range (start > stop) -> error. */
	zassert_equal(-EINVAL,
		      etc_device_record_reclaim_available(base + RECLAIM_WIN_STOP,
							  base + RECLAIM_WIN_START),
		      "start > stop should be rejected");

	/* The check is side-effect free: a real reclaim still schedules afterwards. */
	int rc =
		etc_device_record_reclaim(base + RECLAIM_WIN_START, base + RECLAIM_WIN_STOP, false);
	zassert_true(rc >= 0, "reclaim schedule failed %d", rc);
	zassert_true(etc_device_record_num_reclaim_records() > 0,
		     "reclaim window not scheduled after availability check");
}

ZTEST_SUITE(etc_device_record_test, NULL, test_setup, NULL, NULL, test_teardown);
```

## src/relay.c
```c
/*
 * Copyright (c) 2024 EXACT Technology Corporation
 */

#include <stdbool.h>
#include <string.h>
#include <zephyr/ztest.h>

#include "etc_device.h"
#include "etc_relay_reclaim.h"
#include "etc_util.h"
#include "common.h"
#include <zephyr/logging/log.h>
#include <zephyr/random/random.h>

#include <zephyr/logging/log.h>
#include <zephyr/random/random.h>

LOG_MODULE_REGISTER(etc_device_relay_test, CONFIG_ETC_APP_LOG_LEVEL);

/* No splitter connected: IN5-IN8 all invalid → splitter fields omitted */
#define RELAY_LEGACY_DATA_STR                                                                      \
	"1.2.5,-99,10000199,4.12,*,3.99,*,0.0.0-twister,1,1738795004,41.2,41.6,35.3,*,23.5,*,1,0,"

static struct etc_device_relay_record record = {
	.battery = 4.12,
	.is_reclaim = false,
	.logger_rssi = -99,
	.packet_number = 1,
	.timestamp = 1738795004,
	.relay_id = "OPEN",
	.logger_ver = "1.2.5",
	.logger_id = "10000199",
	.sensor = {41.2, 41.6, 35.32, SENSOR_TEMP_NO_CONNECTED, SENSOR_TEMP_NO_CONNECTED,
		   SENSOR_TEMP_NO_CONNECTED, SENSOR_TEMP_NO_CONNECTED, SENSOR_TEMP_NO_CONNECTED,
		   23.5, SENSOR_HUMID_NO_CONNECTED},
	.data = {ETC_DEVICE_INVALID_VALUE_ELEMENT},
};

/* Splitter connected: IN5 has a valid reading → all 4 splitter fields included */
#define RELAY_LEGACY_DATA_SPLITTER_STR                                                             \
	"1.2.5,-99,10000199,4.12,*,3.99,*,0.0.0-twister,1,1738795004,41.2,41.6,35.3,*,23.5,*,"     \
	"1,0,22.5,*,*,*,"

static struct etc_device_relay_record record_splitter = {
	.battery = 4.12,
	.is_reclaim = false,
	.logger_rssi = -99,
	.packet_number = 1,
	.timestamp = 1738795004,
	.relay_id = "OPEN",
	.logger_ver = "1.2.5",
	.logger_id = "10000199",
	.sensor = {41.2, 41.6, 35.32, SENSOR_TEMP_NO_CONNECTED, 22.5, SENSOR_TEMP_NO_CONNECTED,
		   SENSOR_TEMP_NO_CONNECTED, SENSOR_TEMP_NO_CONNECTED, 23.5,
		   SENSOR_HUMID_NO_CONNECTED},
	.data = {ETC_DEVICE_INVALID_VALUE_ELEMENT},
};

static struct etc_device_relay_packet packet;

#define BUF_SIZE 512
char buf[BUF_SIZE];

static void *test_setup(void)
{
	for (int i = 0; i < ETC_DEVICE_RELAY_PACKAGE_MAX_RECORDS; i++) {
		memcpy(&packet.records[i], &record, sizeof(record));
	}
	packet.num_records = ETC_DEVICE_RELAY_PACKAGE_MAX_RECORDS;

	return NULL;
}

ZTEST(etc_device_relay_test, test_single_legacy_data)
{
	int len;
	int ret;

	ret = etc_common_prepare_relay_legacy_data(&record, buf, &len, sizeof(buf));
	zassert_ok(ret);
	LOG_INF("%s", buf);
	zassert_equal(len, strlen(buf));
	zassert_mem_equal(buf, RELAY_LEGACY_DATA_STR, len);
}

ZTEST(etc_device_relay_test, test_single_legacy_data_with_splitter)
{
	int len;
	int ret;

	ret = etc_common_prepare_relay_legacy_data(&record_splitter, buf, &len, sizeof(buf));
	zassert_ok(ret);
	LOG_INF("%s", buf);
	zassert_equal(len, strlen(buf));
	zassert_mem_equal(buf, RELAY_LEGACY_DATA_SPLITTER_STR, len);
}

ZTEST(etc_device_relay_test, test_legacy_data_packet)
{
	int len;
	int ret;

	ret = etc_common_prepare_relay_legacy_packet(&packet, buf, &len, sizeof(buf));
	zassert_ok(ret);
	LOG_INF("%s", buf);
	zassert_equal(len, strlen(buf));
	zassert_mem_equal(buf,
			  RELAY_LEGACY_DATA_STR "|" RELAY_LEGACY_DATA_STR "|" RELAY_LEGACY_DATA_STR
						"|" RELAY_LEGACY_DATA_STR "|" RELAY_LEGACY_DATA_STR,
			  len);
}

ZTEST(etc_device_relay_test, test_legacy_data_packet_partial_fits)
{
	/* Five splitter-bearing records exceed a small buffer. The encoder must pack
	 * as many as fit, report the reduced count, and finish well-formed instead of
	 * failing the whole package (which would stall the relay queue, FW-886). */
	struct etc_device_relay_packet p;
	char small_buf[256];
	int len = 0;
	int ret;

	for (int i = 0; i < ETC_DEVICE_RELAY_PACKAGE_MAX_RECORDS; i++) {
		memcpy(&p.records[i], &record_splitter, sizeof(record_splitter));
	}
	p.num_records = ETC_DEVICE_RELAY_PACKAGE_MAX_RECORDS;

	ret = etc_common_prepare_relay_legacy_packet(&p, small_buf, &len, sizeof(small_buf));
	zassert_ok(ret, "partial pack must succeed, not stall");

	/* At least one record packed, but not all five (the buffer is too small). */
	zassert_true(p.num_records >= 1, "must pack at least one record");
	zassert_true(p.num_records < ETC_DEVICE_RELAY_PACKAGE_MAX_RECORDS,
		     "count must be reduced when the buffer cannot hold all records");

	/* Well-formed: NUL-terminated at len, within bounds, no trailing separator. */
	zassert_equal(len, (int)strlen(small_buf));
	zassert_true(len < (int)sizeof(small_buf));
	zassert_not_equal(small_buf[len - 1], '|', "no trailing separator");

	/* Exactly (num_records - 1) separators join the packed records. */
	int separators = 0;
	for (int i = 0; i < len; i++) {
		if (small_buf[i] == '|') {
			separators++;
		}
	}
	zassert_equal(separators, p.num_records - 1, "one '|' between each record");

	/* The first record is the intact splitter CSV (not truncated). */
	zassert_mem_equal(small_buf, RELAY_LEGACY_DATA_SPLITTER_STR,
			  strlen(RELAY_LEGACY_DATA_SPLITTER_STR));
}

ZTEST(etc_device_relay_test, test_relay_read_init)
{
	struct etc_device_relay_packet p;
	int ret;

	ret = etc_device_read_relay_data_packet(&p);
	zassert_not_ok(ret);
}

ZTEST(etc_device_relay_test, test_relay_write_read_single)
{
	struct etc_device_relay_packet p;
	int ret;
	
	memset(&p, 0, sizeof(p));

	ret = etc_device_write_relay_data(&record);
	zassert_ok(ret);
	ret = etc_device_read_relay_data_packet(&p);
	zassert_ok(ret);
	zassert_equal(p.num_records, 1);
	zassert_mem_equal(&p.records[0], &record, sizeof(record));
	ret = etc_device_sync_relay_data();
	zassert_ok(ret);
}

ZTEST(etc_device_relay_test, test_relay_double_sync)
{
	struct etc_device_relay_packet p;
	int ret;
	
	memset(&p, 0, sizeof(p));

	ret = etc_device_write_relay_data(&record);
	zassert_ok(ret);
	ret = etc_device_read_relay_data_packet(&p);
	zassert_ok(ret);
	zassert_equal(p.num_records, 1);
	zassert_mem_equal(&p.records[0], &record, sizeof(record));
	ret = etc_device_sync_relay_data();
	zassert_ok(ret);
	ret = etc_device_sync_relay_data();
	zassert_not_ok(ret);
}

ZTEST(etc_device_relay_test, test_relay_write_read_multiple)
{
	struct etc_device_relay_record r;
	struct etc_device_relay_packet p;
	int ret;

	memcpy(&r, &record, sizeof(record));

	for (int i = 0; i < ETC_DEVICE_RELAY_PACKAGE_MAX_RECORDS; i++) {
		r.data[0] = i + 1;
		ret = etc_device_write_relay_data(&r);
		zassert_ok(ret);
	}
	ret = etc_device_read_relay_data_packet(&p);
	zassert_ok(ret);
	zassert_equal(p.num_records, ETC_DEVICE_RELAY_PACKAGE_MAX_RECORDS);
	
	for (int i = 0; i < ETC_DEVICE_RELAY_PACKAGE_MAX_RECORDS; i++) {
		r.data[0] = i + 1;
		zassert_mem_equal(&p.records[i], &r, sizeof(r));
	}
	ret = etc_device_sync_relay_data();
	zassert_ok(ret);
}

ZTEST(etc_device_relay_test, test_relay_write_full_read_empty)
{
	struct etc_device_relay_record r;
	struct etc_device_relay_packet p;
	int ret;
	int max_reads =
		ETC_RELAY_RECORD_MAX_ELEMENT / ETC_DEVICE_RELAY_PACKAGE_MAX_RECORDS +
		(ETC_RELAY_RECORD_MAX_ELEMENT % ETC_DEVICE_RELAY_PACKAGE_MAX_RECORDS == 0 ? 0 : 1);
	int num_records;

	memcpy(&r, &record, sizeof(record));

	for (int i = 0; i < ETC_RELAY_RECORD_MAX_ELEMENT; i++) {
		r.data[0] = i + 1;
		ret = etc_device_write_relay_data(&r);
		zassert_ok(ret);
	}
	ret = etc_device_write_relay_data(&r);
	zassert_not_ok(ret);

	for (int i = 0; i < max_reads; i++) {
		ret = etc_device_read_relay_data_packet(&p);
		zassert_ok(ret);
		ret = etc_device_sync_relay_data();
		zassert_ok(ret);
		num_records =
			i >= ETC_RELAY_RECORD_MAX_ELEMENT / ETC_DEVICE_RELAY_PACKAGE_MAX_RECORDS
				? ETC_RELAY_RECORD_MAX_ELEMENT %
					  ETC_DEVICE_RELAY_PACKAGE_MAX_RECORDS
				: ETC_DEVICE_RELAY_PACKAGE_MAX_RECORDS;
		zassert_equal(p.num_records, num_records);
		for (int j = 0; j < num_records; j++) {
			r.data[0] = (ETC_DEVICE_RELAY_PACKAGE_MAX_RECORDS * i) + j + 1;
			zassert_mem_equal(&p.records[j], &r, sizeof(r),
					  "got: %d expected: %d, i: %d, j: %d",
					  p.records[j].data[0], r.data[0], i, j);
		}
	}
	ret = etc_device_read_relay_data_packet(&p);
	zassert_not_ok(ret);
}

/* --- FW-991: reclaim buffer query / clear / iterate APIs ---------------- */

static void reclaim_reset(void)
{
	(void)etc_relay_reclaim_clear_all();
}

ZTEST(etc_device_relay_test, test_reclaim_count_empty)
{
	reclaim_reset();
	zassert_equal(etc_relay_reclaim_count(), 0);
}

ZTEST(etc_device_relay_test, test_reclaim_add_and_count)
{
	reclaim_reset();
	char id_a[] = "10000100";
	char id_b[] = "10000200";
	zassert_ok(etc_relay_reclaim_set(id_a, 1000, 2000));
	zassert_ok(etc_relay_reclaim_set(id_b, 3000, 4000));
	zassert_equal(etc_relay_reclaim_count(), 2);
}

ZTEST(etc_device_relay_test, test_reclaim_get_by_index_bounds)
{
	reclaim_reset();
	struct etc_device_reclaim_request out;
	zassert_equal(etc_relay_reclaim_get_by_index(-1, &out), -EINVAL);
	zassert_equal(etc_relay_reclaim_get_by_index(ETC_RECLAIM_RELAY_MAX_ELEMENT, &out), -EINVAL);
	zassert_equal(etc_relay_reclaim_get_by_index(0, &out), -ENOENT);
}

ZTEST(etc_device_relay_test, test_reclaim_get_by_index_active)
{
	reclaim_reset();
	char id[] = "10000101";
	zassert_ok(etc_relay_reclaim_set(id, 1111, 2222));

	struct etc_device_reclaim_request out;
	zassert_ok(etc_relay_reclaim_get_by_index(0, &out));
	zassert_equal(out.start_time, 1111);
	zassert_equal(out.stop_time, 2222);
	zassert_ok(strcmp(out.logger_id, id));
}

ZTEST(etc_device_relay_test, test_reclaim_clear_all_returns_prior_count)
{
	reclaim_reset();
	char id[] = "10000102";
	zassert_ok(etc_relay_reclaim_set(id, 1, 2));
	zassert_ok(etc_relay_reclaim_set(id, 3, 4));
	zassert_ok(etc_relay_reclaim_set(id, 5, 6));
	zassert_equal(etc_relay_reclaim_clear_all(), 3);
	zassert_equal(etc_relay_reclaim_count(), 0);
}

struct logger_match_ctx {
	const char *target;
	int matches;
};

static void count_logger_matches(int idx, const struct etc_device_reclaim_request *req, void *ctx_v)
{
	struct logger_match_ctx *ctx = ctx_v;
	ARG_UNUSED(idx);
	if (strcmp(req->logger_id, ctx->target) == 0) {
		ctx->matches++;
	}
}

ZTEST(etc_device_relay_test, test_reclaim_for_each_filters_logger)
{
	reclaim_reset();
	char id_a[] = "10000301";
	char id_b[] = "10000302";
	zassert_ok(etc_relay_reclaim_set(id_a, 1, 2));
	zassert_ok(etc_relay_reclaim_set(id_b, 3, 4));
	zassert_ok(etc_relay_reclaim_set(id_a, 5, 6));

	struct logger_match_ctx ctx = {.target = id_a, .matches = 0};
	int visited = etc_relay_reclaim_for_each(count_logger_matches, &ctx);
	zassert_equal(visited, 3);
	zassert_equal(ctx.matches, 2);
}

ZTEST(etc_device_relay_test, test_reclaim_full_returns_enomem)
{
	reclaim_reset();
	char id[] = "10000400";
	/* Fill every slot with fresh requests so no stale eviction is possible. */
	for (int i = 0; i < ETC_RECLAIM_RELAY_MAX_ELEMENT; i++) {
		zassert_ok(etc_relay_reclaim_set(id, i * 10, i * 10 + 5));
	}
	zassert_equal(etc_relay_reclaim_count(), ETC_RECLAIM_RELAY_MAX_ELEMENT);

	int rc = etc_relay_reclaim_set(id, 9999, 10000);
	zassert_equal(rc, -ENOMEM,
		      "Expected -ENOMEM when buffer full with no stale entries, got %d", rc);
}

ZTEST_SUITE(etc_device_relay_test, NULL, test_setup, NULL, NULL, NULL);
```

## src/two_port.c
```c
/*
 * Copyright (c) 2026 EXACT Technology Corporation
 */

#include <stdbool.h>
#include <string.h>
#include <zephyr/ztest.h>

#include "etc_device.h"
#include "etc_device_helper.h"

/* Provided by the mocked etc_settings so each test can pick the device type
 * that etc_device_map_two_port_sensor_data() reads via etc_get_device_type().
 */
void mock_set_device_type(enum etc_device_type type);

/* IN1=10, IN2=11, IN3=12, IN4=13, IN5(1.B)=20, IN6(2.B)=21, IN7/IN8 unused,
 * ambient=23.5, humidity invalid.
 */
static void seed_sensors(float *sensor)
{
	sensor[SENSOR_INPUT_IN1] = 10.0f;
	sensor[SENSOR_INPUT_IN2] = 11.0f;
	sensor[SENSOR_INPUT_IN3] = 12.0f;
	sensor[SENSOR_INPUT_IN4] = 13.0f;
	sensor[SENSOR_INPUT_IN5] = 20.0f;
	sensor[SENSOR_INPUT_IN6] = 21.0f;
	sensor[SENSOR_INPUT_IN7] = 30.0f;
	sensor[SENSOR_INPUT_IN8] = 31.0f;
	sensor[SENSOR_INPUT_AMBIENT] = 23.5f;
	sensor[SENSOR_INPUT_HUMID] = SENSOR_HUMID_NO_CONNECTED;
}

/* The 2-way splitter sub-ports (IN5/IN6) must land in IN3/IN4 and be cleared. */
static void assert_two_port_mapped(const float *sensor)
{
	zassert_equal(sensor[SENSOR_INPUT_IN1], 10.0f);
	zassert_equal(sensor[SENSOR_INPUT_IN2], 11.0f);
	zassert_equal(sensor[SENSOR_INPUT_IN3], 20.0f, "1.B must map to IN3");
	zassert_equal(sensor[SENSOR_INPUT_IN4], 21.0f, "2.B must map to IN4");
	zassert_equal(sensor[SENSOR_INPUT_IN5], (float)SENSOR_TEMP_NO_CONNECTED);
	zassert_equal(sensor[SENSOR_INPUT_IN6], (float)SENSOR_TEMP_NO_CONNECTED);
	/* A 2-port device has no 3.B/4.B; IN7/IN8 must be cleared too. */
	zassert_equal(sensor[SENSOR_INPUT_IN7], (float)SENSOR_TEMP_NO_CONNECTED);
	zassert_equal(sensor[SENSOR_INPUT_IN8], (float)SENSOR_TEMP_NO_CONNECTED);
}

ZTEST(etc_device_two_port_test, test_embeddable_maps_splitter)
{
	float sensor[SENSOR_INPUT_MAX];

	seed_sensors(sensor);
	mock_set_device_type(ETC_DEVICE_TYPE_EMBEDDABLE);
	etc_device_map_two_port_sensor_data(sensor);
	assert_two_port_mapped(sensor);
}

ZTEST(etc_device_two_port_test, test_ambient_maps_splitter)
{
	float sensor[SENSOR_INPUT_MAX];

	seed_sensors(sensor);
	mock_set_device_type(ETC_DEVICE_TYPE_AMBIENT);
	etc_device_map_two_port_sensor_data(sensor);
	assert_two_port_mapped(sensor);
}

ZTEST(etc_device_two_port_test, test_logger_unchanged)
{
	float sensor[SENSOR_INPUT_MAX];

	seed_sensors(sensor);
	mock_set_device_type(ETC_DEVICE_TYPE_LOGGER);
	etc_device_map_two_port_sensor_data(sensor);

	zassert_equal(sensor[SENSOR_INPUT_IN3], 12.0f, "logger IN3 must be untouched");
	zassert_equal(sensor[SENSOR_INPUT_IN4], 13.0f, "logger IN4 must be untouched");
	zassert_equal(sensor[SENSOR_INPUT_IN5], 20.0f, "logger IN5 must be untouched");
	zassert_equal(sensor[SENSOR_INPUT_IN6], 21.0f, "logger IN6 must be untouched");
	zassert_equal(sensor[SENSOR_INPUT_IN7], 30.0f, "logger IN7 must be untouched");
	zassert_equal(sensor[SENSOR_INPUT_IN8], 31.0f, "logger IN8 must be untouched");
}

static void test_two_port_after(void *fixture)
{
	ARG_UNUSED(fixture);
	/* Restore the default so other suites in this binary are unaffected. */
	mock_set_device_type(ETC_DEVICE_TYPE_LOGGER);
}

ZTEST_SUITE(etc_device_two_port_test, NULL, NULL, NULL, test_two_port_after, NULL);
```
