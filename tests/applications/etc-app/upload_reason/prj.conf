## CMakeLists.txt
```
#SPDX - License - Identifier : Apache - 2.0

cmake_minimum_required(VERSION 3.20.0)
find_package(Zephyr REQUIRED HINTS $ENV{ZEPHYR_BASE})
project(upload_reason)

string(TIMESTAMP UNIX_TIME "%s")
message("Compile this project at : ${UNIX_TIME}")
if(DEFINED ENV{VERSION})
project(app LANGUAGES C VERSION $ENV{VERSION})
else()
project(app LANGUAGES C VERSION 0.0.0)
endif()

configure_file(app_version.h.in ${CMAKE_BINARY_DIR}/app/include/app_version.h)

FILE(GLOB app_sources src/*.c
                      src/mock/*.c
                      src/mock/cloud/cloud_codec/lwm2m/lwm2m_codec_helpers.c
                      src/mock/zephyr/drivers/*.c)

target_sources(app PRIVATE ${app_sources})

target_compile_options(app PRIVATE -Wno-error=double-promotion)

set(APP_SRC_DIR ../../../../applications/etc-app/src)
set(DRIVER_SRC_DIR ../../../../drivers)

target_sources(app PRIVATE 
                ${APP_SRC_DIR}/modules/app_module_helper.c
                ${APP_SRC_DIR}/exact/etc_devices/etc_device.c
                ${APP_SRC_DIR}/exact/etc_devices/etc_device_record.c
                ${APP_SRC_DIR}/exact/etc_settings/etc_settings.c
                ${APP_SRC_DIR}/exact/etc_memfault/etc_memfault_dummy.c
                ${APP_SRC_DIR}/exact/etc_util/etc_util.c
)

set(INCLUDE_DIRS
        src
        src/mock
        src/mock/zephyr/drivers
        ${APP_SRC_DIR}/exact/etc_devices
        ${APP_SRC_DIR}/exact/etc_memfault
        ${APP_SRC_DIR}/exact/etc_settings
        ${APP_SRC_DIR}/exact/etc_sensor
        ${APP_SRC_DIR}/exact/etc_util
        ${APP_SRC_DIR}/exact/etc_calibration
        ${APP_SRC_DIR}/exact/etc_functional_test
        ${APP_SRC_DIR}/modules
        ${APP_SRC_DIR}
)

list(REMOVE_ITEM INCLUDE_DIRS ${APP_SRC_DIR}/cloud)

target_include_directories(app PRIVATE ${INCLUDE_DIRS}
        ${CMAKE_BINARY_DIR}/app/include
)

zephyr_compile_definitions_ifdef(CONFIG_BOARD_NATIVE_SIM CONFIG_BOARD_VERSION="0.0.0")
zephyr_compile_definitions(CONFIG_LWM2M_SECURITY_KEY_SIZE=33)
zephyr_compile_definitions(CONFIG_SERIAL_NUMBER_TYPE=1)
zephyr_compile_definitions(CONFIG_SERIAL_NUMBER_DEFAULT_VALUE=10000000)
zephyr_compile_definitions(CONFIG_LWM2M_INTEGRATION_PSK="70475440693636213646256D7744")
zephyr_compile_definitions(CONFIG_MODEM_MODULE_GNSS_TIMEOUT_S=60)
zephyr_compile_definitions(CONFIG_ETC_APP_THRESHOLD_MIN_REPORT_INTERVAL_S=900)
zephyr_compile_definitions(CONFIG_MODEM_MODULE_MAX_CONNECTION_TIME_S=60)
zephyr_compile_definitions(IMAGE_HASH_LEN=32)
zephyr_compile_definitions(CONFIG_ETC_APP_LOG_LEVEL=3)
zephyr_compile_definitions(CONFIG_ETC_SETTINGS_LOG_LEVEL=3)
zephyr_compile_definitions(CONFIG_ETC_DEVICE_RELAY_MAX_RECORD_HISTORY=64)
zephyr_compile_definitions(CONFIG_ETC_DEVICE_SAVE_RECORD_SEC=1)
zephyr_compile_definitions(CONFIG_ETC_APP_LTE_SYNC_NACK_THRESHOLD=4)
zephyr_compile_definitions(CONFIG_ETC_APP_LTE_SYNC_BACKOFF_MULTIPLE=4)
zephyr_compile_definitions(CONFIG_ETC_APP_LTE_SYNC_BACKOFF_MAX_S=86400)
zephyr_compile_definitions(CONFIG_LWM2M_ETC_RELAY_OBJ_DATA_SIZE=512)
```

## prj.conf
```kconfig
CONFIG_ZTEST=y
CONFIG_HEAP_MEM_POOL_SIZE=8192
CONFIG_RETAINED_MEM=y

CONFIG_FLASH=y
CONFIG_FLASH_PAGE_LAYOUT=y
CONFIG_FLASH_MAP=y
CONFIG_NVS=y

# Settings - Used to store real-time device configuration to flash.
CONFIG_SETTINGS=y
CONFIG_SETTINGS_FCB=y
CONFIG_FCB=y

CONFIG_POSIX_API=y

# Application Event Manager
CONFIG_APP_EVENT_MANAGER=y
CONFIG_APP_EVENT_MANAGER_LOG_EVENT_TYPE=n

CONFIG_TEST_RANDOM_GENERATOR=y
```

## boards/native_sim.conf
```kconfig
CONFIG_FLASH_SIMULATOR=y

CONFIG_RETAINED_MEM_ZEPHYR_RAM=n
CONFIG_RETAINED_MEM_MOCK_RAM=y
```

## src/main.c
```c
/*
 * Copyright (c) 2026 EXACT Technology Corporation
 */

#include <zephyr/ztest.h>
#include "etc_device.h"
#include "app_module_helper.h"

static const enum app_upload_reason all_reasons[] = {
	APP_UPLOAD_NONE,
	APP_UPLOAD_NORMAL,
	APP_UPLOAD_THRESHOLD,
	APP_UPLOAD_LORA_SYNC,
	APP_UPLOAD_MAGNET,
};

/* Rank expected from the merge: MAGNET > LORA_SYNC > THRESHOLD > NORMAL > NONE. */
static int reason_rank(enum app_upload_reason reason)
{
	switch (reason) {
	case APP_UPLOAD_NONE:
		return 0;
	case APP_UPLOAD_NORMAL:
		return 1;
	case APP_UPLOAD_THRESHOLD:
		return 2;
	case APP_UPLOAD_LORA_SYNC:
		return 3;
	case APP_UPLOAD_MAGNET:
		return 4;
	}
	return -1;
}

ZTEST(upload_reason, test_merge_full_matrix)
{
	for (size_t i = 0; i < ARRAY_SIZE(all_reasons); i++) {
		for (size_t j = 0; j < ARRAY_SIZE(all_reasons); j++) {
			enum app_upload_reason a = all_reasons[i];
			enum app_upload_reason b = all_reasons[j];
			enum app_upload_reason merged = app_module_upload_reason_merge(a, b);
			enum app_upload_reason expected =
				reason_rank(a) >= reason_rank(b) ? a : b;

			zassert_equal(merged, expected,
				      "merge(%d, %d) = %d, expected %d", a, b, merged,
				      expected);
			/* Commutativity */
			zassert_equal(merged, app_module_upload_reason_merge(b, a),
				      "merge(%d, %d) is not commutative", a, b);
		}
	}
}

ZTEST(upload_reason, test_merge_none_none_is_none)
{
	/* The dispatch-NONE-is-a-noop invariant rests on NONE never winning a
	 * merge into a non-NONE request and merge(NONE, NONE) staying NONE. */
	zassert_equal(app_module_upload_reason_merge(APP_UPLOAD_NONE, APP_UPLOAD_NONE),
		      APP_UPLOAD_NONE);
}

ZTEST(upload_reason, test_from_schedule)
{
	zassert_equal(app_module_upload_reason_from_schedule(APP_WAKEUP_TX_INTERVAL_WORK),
		      APP_UPLOAD_NORMAL);
	zassert_equal(app_module_upload_reason_from_schedule(APP_WAKEUP_TX_PROBE_WORK),
		      APP_UPLOAD_NORMAL);
	zassert_equal(
		app_module_upload_reason_from_schedule(APP_WAKEUP_TX_SYNC_CLOUD_FOR_LORA_WORK),
		APP_UPLOAD_LORA_SYNC);
	zassert_equal(
		app_module_upload_reason_from_schedule(APP_WAKEUP_TX_SYNC_CLOUD_FOR_MAGNET_WORK),
		APP_UPLOAD_MAGNET);
}

ZTEST(upload_reason, test_from_schedule_never_threshold)
{
	/* Only a threshold crossing arms APP_UPLOAD_THRESHOLD; no scheduled
	 * wakeup may produce it. */
	const enum app_wakeup_tx_work_type all_schedules[] = {
		APP_WAKEUP_TX_INTERVAL_WORK,
		APP_WAKEUP_TX_PROBE_WORK,
		APP_WAKEUP_TX_SYNC_CLOUD_FOR_LORA_WORK,
		APP_WAKEUP_TX_SYNC_CLOUD_FOR_MAGNET_WORK,
	};

	for (size_t i = 0; i < ARRAY_SIZE(all_schedules); i++) {
		zassert_not_equal(app_module_upload_reason_from_schedule(all_schedules[i]),
				  APP_UPLOAD_THRESHOLD, "schedule %d yielded THRESHOLD",
				  all_schedules[i]);
	}
}

ZTEST(upload_reason, test_sub_job_for_reason)
{
	zassert_equal(app_module_sub_job_for_reason(APP_UPLOAD_NONE), ETC_TRANSMIT_NORMAL);
	zassert_equal(app_module_sub_job_for_reason(APP_UPLOAD_NORMAL), ETC_TRANSMIT_NORMAL);
	zassert_equal(app_module_sub_job_for_reason(APP_UPLOAD_THRESHOLD), ETC_TRANSMIT_NORMAL);
	zassert_equal(app_module_sub_job_for_reason(APP_UPLOAD_LORA_SYNC),
		      ETC_TRANSMIT_SYNC_CLOUD_LORA);
	zassert_equal(app_module_sub_job_for_reason(APP_UPLOAD_MAGNET),
		      ETC_TRANSMIT_SYNC_MAGNET);
}

ZTEST_SUITE(upload_reason, NULL, NULL, NULL, NULL, NULL);
```
