## applications/etc-core/src/drivers/Kconfig
```kconfig
rsource "bq24195/Kconfig"
rsource "pcf85263/Kconfig"
rsource "onewire/Kconfig"
rsource "ds18s20/Kconfig"
rsource "adc/Kconfig"
```

## applications/etc-core/src/drivers/adc/Kconfig
```kconfig
menuconfig ADC_MODULES
	bool "Configure for ADC module"
	depends on ADC
	help
	  Enable ADC Modules 

if ADC_MODULES

config ADC_MODULES_SAMPLE_RATE_MSEC
	int "Sample rate time in mseconds"
	default 500
	help
	  This is sample ADC rate

endif # ADC_MODULES
```

## applications/etc-core/src/drivers/bq24195/Kconfig
```kconfig
menuconfig BQ24195
	bool "BQ24195 Power Management Integrated Circuits (PMIC)"
	depends on I2C
	help
	  Enable I2C-based driver for BQ24195 PMIC.

if BQ24195

endif # BQ24195
```

## applications/etc-core/src/drivers/ds18s20/Kconfig
```kconfig
config DS18S20
	bool "DS18S20 Temperature and Humidity Sensor"
	depends on DS2484
	help
	  Enable driver for the DS18S20 temperature and humidity sensor family.

if DS18S20

config DS18S20_THREAD_STACK_SIZE
	int "Stack size for the quectel BG9X modem driver RX thread"
	default 1028
	help
	  This stack is used by the quectel BG9X RX thread.

endif
```

## applications/etc-core/src/drivers/onewire/Kconfig
```kconfig
config DS2484
	bool "Bridge I2C to One-wire driver"
	depends on I2C
	help
	  Enable driver for the DS2484 the bridge I2C to One-wire protocol.
```

## applications/etc-core/src/power/Kconfig
```kconfig
config POWER_MODULE
	bool "Enable Power module"
	select PM
	select PM_DEVICE
	default y
	help
		Enable the Power Management Module

menu "Power Management Module"
	visible if POWER_MODULE

config POWER_MODULE_RTC
	bool "Use RTC to control wakeup power"
	default y
	select COUNTER

if POWER_MODULE_RTC

config POWER_MODULE_RTC_NAME
	string "Power module device name for wakeup"
	default "RTC0"

config POWER_MODULE_SLEEP_TIME_SECOND
	int "Time for sleep"
	default 1800

endif

endmenu

module = POWER
module-str = Power
source "${ZEPHYR_BASE}/subsys/logging/Kconfig.template.log_config"
```

## applications/etc-lowpower/Kconfig
```kconfig
menu "EXACT Core 2.0 Low Power Test Application"
endmenu

menu "Zephyr Kernel"
source "$ZEPHYR_BASE/Kconfig.zephyr"
endmenu

module = ETC_LOWPOWER
module-str = ETC Low Power
source "${ZEPHYR_BASE}/subsys/logging/Kconfig.template.log_config"
```

## applications/etc-lowpower/boards/etc.conf
```kconfig
CONFIG_LORA=y
CONFIG_LORA_SX127X=y
CONFIG_SPI=y
CONFIG_PWM=n

CONFIG_I2C=y
CONFIG_PCF85263=y

# Enable Power Management module
CONFIG_PM=y
CONFIG_PM_DEVICE=y
```

## applications/etc-lowpower/boards/etc_lp.conf
```kconfig
#CONFIG_LORA=y
#CONFIG_LORA_SX12XX=y
CONFIG_SPI=n
CONFIG_PWM=n

CONFIG_I2C=n

# Enable Power Management module
# CONFIG_PM=y
# CONFIG_PM_DEVICE=y
```

## applications/etc-lowpower/boards/etc_ninab4.conf
```kconfig
CONFIG_PWM=n
CONFIG_SPI=n

CONFIG_I2C=n

# Enable Power Management module
# CONFIG_PM=y
# CONFIG_PM_DEVICE=y
```

## applications/etc-lowpower/boards/etc_v0_2.conf
```kconfig
CONFIG_LORA=y
CONFIG_LORA_SX12XX=y
CONFIG_SPI=y
CONFIG_PWM=n

CONFIG_I2C=y
CONFIG_PCF85263=y

# Enable Power Management module
CONFIG_PM=y
CONFIG_PM_DEVICE=y
```

## applications/etc-lowpower/child_image/mcuboot/boards/etc_ninab4.conf
```kconfig
CONFIG_SINGLE_APPLICATION_SLOT=y
CONFIG_PM_EXTERNAL_FLASH_MCUBOOT_SECONDARY=n

CONFIG_SPI=n
CONFIG_SPI_NOR=n
CONFIG_PARTITION_MANAGER_ENABLED=n
```

## applications/etc-lwm2m/boards/etc.conf
```kconfig
# Enable LOG
CONFIG_LOG=y
CONFIG_LOG_BUFFER_SIZE=4096

# Heap and stacks
CONFIG_HEAP_MEM_POOL_SIZE=4096
CONFIG_MAIN_STACK_SIZE=4096
CONFIG_SYSTEM_WORKQUEUE_STACK_SIZE=2048

# Settings - Used to store real-time device configuration to flash.
CONFIG_SETTINGS=y
CONFIG_SETTINGS_FCB=y
CONFIG_FCB=y

# Non-volatile Storage
CONFIG_NVS=y

# Enable statistics and statistic names.
CONFIG_STATS=y
CONFIG_STATS_NAMES=y

# Disable boot banner. printk outputs get dropped w/ usbcdc
CONFIG_BOOT_BANNER=n

# CJSON
CONFIG_CJSON_LIB=y

# Peripherals
CONFIG_ADC=y
CONFIG_ADC_MODULES_SAMPLE_RATE_MSEC=30000
CONFIG_ADC_MODULES=y
CONFIG_SENSOR=y
CONFIG_BQ24195=y
CONFIG_PCF85263=y
CONFIG_DS18B20_TIMER=y

# GUI over LED
CONFIG_UI_MODULE=y
CONFIG_UI_LED_USE_PWM=y
CONFIG_UI_LOG_LEVEL_DBG=y

# Partition Manager
CONFIG_PM_PARTITION_SIZE_LITTLEFS=0x180000
CONFIG_PM_PARTITION_REGION_LITTLEFS_EXTERNAL=y

# Enable Shell
CONFIG_SHELL=y

# Enable uart console
CONFIG_UART_CONSOLE=y
CONFIG_USB_COMPOSITE_DEVICE=y
CONFIG_USB_DEVICE_STACK=y
CONFIG_USB_DEVICE_INITIALIZE_AT_BOOT=y
CONFIG_SHELL_BACKEND_SERIAL_CHECK_DTR=y
CONFIG_UART_LINE_CTRL=y
CONFIG_SHELL_BACKEND_SERIAL_INIT_PRIORITY=51
CONFIG_SHELL_PROMPT_UART="etc:~$ "

# Enable Network
CONFIG_NETWORKING=y
CONFIG_NET_NATIVE=n

CONFIG_NET_TX_STACK_SIZE=2048
CONFIG_NET_RX_STACK_SIZE=2048

CONFIG_NET_PKT_RX_COUNT=10
CONFIG_NET_PKT_TX_COUNT=10
CONFIG_NET_BUF_RX_COUNT=20
CONFIG_NET_BUF_TX_COUNT=20
CONFIG_NET_MAX_CONTEXTS=10
CONFIG_NET_IPV4=y
CONFIG_NET_IPV6=n
CONFIG_NET_CONFIG_NEED_IPV6=n
CONFIG_NET_SOCKETS_OFFLOAD=y
CONFIG_NET_TCP=y
CONFIG_NET_LOG=y
CONFIG_INIT_STACKS=y

CONFIG_NET_SHELL=y

# Enable Modem
CONFIG_MODEM=y
CONFIG_MODEM_SHELL=y
CONFIG_MODEM_QUECTEL_BG95_M3=y
CONFIG_MODEM_LOG_LEVEL_DBG=y
CONFIG_MODEM_CONTEXT_VERBOSE_DEBUG=y

# Sockets
CONFIG_NET_SOCKETS=y
CONFIG_NET_SOCKETS_POSIX_NAMES=y
CONFIG_NET_SOCKETS_POLL_MAX=4
```

## applications/etc-test/src/etc_devices/Kconfig
```kconfig
menuconfig ETC_DEVICE
	bool "Mode for ETC Monitor Device"
	default y
	help
	  Selection for ETC Flex Setting/Calibration storage

if ETC_DEVICE

config ETC_DEVICE_INIT_PRIORITY
	int "etc_device init priority"
	default APPLICATION_INIT_PRIORITY
	help
	  Init priority for the etc_device module, which includes initializing
	  NVS.

module = ETC_DEVICE
module-str = device
source "subsys/logging/Kconfig.template.log_config"

endif
```

## applications/etc-test/src/modules/Kconfig
```kconfig
module = ETC_WATCHDOG
module-str = ETC Watchdog
source "${ZEPHYR_BASE}/subsys/logging/Kconfig.template.log_config"
```

## boards/arm/etc/Kconfig.board
```kconfig
config BOARD_ETC
	bool "ETC Core with nRF52840 and BG95x"
	select HAS_DTS_GPIO
	depends on SOC_NRF52840_QIAA
```

## boards/arm/etc/Kconfig.defconfig
```kconfig
if BOARD_ETC

config BOARD
	default "ETC Core Base version with nRF52840 and BG95x"

config BOARD_VERSION
	string
	default "0.2.0"

config BOARD_ETC_0_3_0
	bool "ETC board version 0.3.0"
	default false

config BT_CTLR
	default BT

endif # BOARD_ETC
```

## boards/arm/etc/Kconfig.etc_flex
```kconfig
config BOARD_ETC
	bool "ETC Core with nRF52840 and BG95x"
	select HAS_DTS_GPIO
	select SOC_NRF52840_QIAA
```

## boards/arm/etc/board.yml
```yaml
board:
  name: etc_flex
  socs:
  # Physical nRF52840 SoC on etc_flex
  - name: nrf52840
  revision:
    format: major.minor.patch
    default: 0.3.0
    exact: false
    revisions:
      - name: 0.2.0
      - name: 0.3.0
```

## boards/arm/etc/etc_defconfig
```kconfig
CONFIG_SOC_SERIES_NRF52X=y
CONFIG_SOC_NRF52840_QIAA=y
CONFIG_BOARD_ETC=y

# Enable hardware stack protection
CONFIG_HW_STACK_PROTECTION=y

# Enable MPU
CONFIG_ARM_MPU=y

# enable console
CONFIG_CONSOLE=y

# Enable UART Console
CONFIG_UART_CONSOLE=y

# Enable RTT
CONFIG_USE_SEGGER_RTT=n

# Enable PinCTRL
CONFIG_PINCTRL=y

CONFIG_SERIAL=y
CONFIG_GPIO=y

# Increase priority of I2C for battery workaround
CONFIG_I2C=y
CONFIG_I2C_INIT_PRIORITY=45

# Flash operation
CONFIG_SPI=y
CONFIG_SPI_NOR_FLASH_LAYOUT_PAGE_SIZE=4096
CONFIG_SPI_NOR=y
CONFIG_FLASH=y
```

## boards/arm/etc_ninab4/Kconfig.board
```kconfig
config BOARD_ETC_NINAB4
	bool "Eval kit for ETC development firmware"
	depends on SOC_NRF52833_QIAA
```

## boards/arm/etc_ninab4/Kconfig.defconfig
```kconfig
# EVK-NINA-B4 board configuration
#
# Copyright (c) 2021 u-blox AG
# SPDX-License-Identifier: Apache-2.0

if BOARD_ETC_NINAB4

config BOARD
	default "ETC Nina B406 development board"

config BT_CTLR
	default BT

endif # BOARD_ETC_NINAB4
```

## boards/arm/etc_ninab4/etc_ninab4_defconfig
```kconfig
CONFIG_SOC_SERIES_NRF52X=y
CONFIG_SOC_NRF52833_QIAA=y
CONFIG_BOARD_ETC_NINAB4=y

# Enable MPU
CONFIG_ARM_MPU=y

# Enable hardware stack protection
CONFIG_HW_STACK_PROTECTION=y

# enable console
CONFIG_CONSOLE=y

# Enable UART Console
CONFIG_UART_CONSOLE=y

# enable GPIO
CONFIG_GPIO=y

# Enable PinCTRL
CONFIG_PINCTRL=y

# NFC Pins is used as a gpio
CONFIG_NFCT_PINS_AS_GPIOS=y

CONFIG_SERIAL=y
CONFIG_GPIO=y

# Enable RTT
CONFIG_USE_SEGGER_RTT=n

CONFIG_I2C=y
CONFIG_SPI=y
```
