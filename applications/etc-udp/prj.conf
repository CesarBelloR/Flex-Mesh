## CMakeLists.txt
```
cmake_minimum_required(VERSION 3.13.1)

find_package(Zephyr REQUIRED HINTS $ENV{ZEPHYR_BASE})

if(DEFINED ENV{VERSION})
project(app LANGUAGES C VERSION $ENV{VERSION})
else()
project(app LANGUAGES C VERSION 0.0.0)
endif()

configure_file(app_version.h.in ${CMAKE_BINARY_DIR}/app/include/app_version.h)

target_include_directories(app PRIVATE 
    ${CMAKE_BINARY_DIR}/app/include 
    src)

target_sources(app PRIVATE src/main.c)
```

## Kconfig
```
menu "EXACT Monitor 2.0 Application"

config APP_VERSION
	string "Application version"
	default "v1.0.0"

config NATIVE_TLS
	bool "Use the native TLS stack instead of the offloaded stack."
	default false

endmenu

menu "Zephyr Kernel"
source "$ZEPHYR_BASE/Kconfig.zephyr"
endmenu

module = ETC_APP
module-str = ETC App
source "${ZEPHYR_BASE}/subsys/logging/Kconfig.template.log_config"
```

## prj.conf
```kconfig
# General config
CONFIG_APP_VERSION="v1.0.0"
CONFIG_NEWLIB_LIBC=y
CONFIG_NEWLIB_LIBC_FLOAT_PRINTF=y
CONFIG_ASSERT=y
CONFIG_REBOOT=y
CONFIG_RESET_ON_FATAL_ERROR=n
CONFIG_FPU=y
CONFIG_FW_INFO=y

# Heap and stacks
CONFIG_HW_STACK_PROTECTION=y

# Flash Settings
CONFIG_FLASH=y
CONFIG_FLASH_PAGE_LAYOUT=y
CONFIG_FLASH_MAP=y
CONFIG_SOC_FLASH_NRF_UICR=y
CONFIG_MPU_ALLOW_FLASH_WRITE=y
CONFIG_STREAM_FLASH_LOG_LEVEL_DBG=y

# Application Event Manager
CONFIG_APP_EVENT_MANAGER=y
CONFIG_APP_EVENT_MANAGER_LOG_EVENT_TYPE=n

# DTLS PSK
CONFIG_MODEM_QUECTEL_BG95_M3_PSK_ID="bg95test"
CONFIG_MODEM_QUECTEL_BG95_M3_PSK_KEY="a0b1c2d3e4"
```

## native-dtls.conf
```kconfig
CONFIG_NATIVE_TLS=y

# Select Zephyr mbedtls
CONFIG_MBEDTLS=y
CONFIG_MBEDTLS_TLS_VERSION_1_2=y
CONFIG_MBEDTLS_DTLS=y

CONFIG_MBEDTLS_DEBUG=y
CONFIG_MBEDTLS_DEBUG_LEVEL=4

# Special MbedTLS changes
CONFIG_MBEDTLS_ENABLE_HEAP=y
CONFIG_MBEDTLS_ENABLE_HEAP=y
CONFIG_MBEDTLS_HEAP_SIZE=8192
CONFIG_MBEDTLS_SSL_MAX_CONTENT_LEN=1500
CONFIG_MBEDTLS_CIPHER_CCM_ENABLED=y

# Mbed TLS support for DTLS CID
# CONFIG_MBEDTLS_SSL_PROTO_DTLS=y
# CONFIG_MBEDTLS_SSL_EXPORT_KEYS=y
# CONFIG_MBEDTLS_SSL_DTLS_CONNECTION_ID=y

# Disable RSA, we don't parse certs: saves flash/memory
CONFIG_MBEDTLS_KEY_EXCHANGE_RSA_ENABLED=n
# Enable PSK instead
CONFIG_MBEDTLS_KEY_EXCHANGE_PSK_ENABLED=y

CONFIG_NET_SOCKETS_SOCKOPT_TLS=y
CONFIG_NET_SOCKETS_TLS_MAX_CONTEXTS=4
CONFIG_NET_SOCKETS_ENABLE_DTLS=y
CONFIG_NET_SOCKETS_OFFLOAD_DISPATCHER=y
# CONFIG_NET_SOCKETS_OFFLOAD_PRIORITY=50

# MbedTLS needs a larger stack
CONFIG_MAIN_STACK_SIZE=2048
CONFIG_SYSTEM_WORKQUEUE_STACK_SIZE=2048
```

## boards/etc_dev.conf
```kconfig
# Network
CONFIG_NETWORKING=y
CONFIG_NET_SOCKETS=y
CONFIG_NET_SOCKETS_OFFLOAD=y
CONFIG_NET_NATIVE=n
CONFIG_NET_IPV4=y
CONFIG_NET_IPV6=n


CONFIG_MODEM=y
CONFIG_MODEM_QUECTEL_BG95_M3=y
CONFIG_MODEM_LOG_LEVEL_DBG=n
CONFIG_MODEM_CONTEXT_VERBOSE_DEBUG=n

CONFIG_LOG=y
CONFIG_ETC_APP_LOG_LEVEL_DBG=y
CONFIG_LOG_BUFFER_SIZE=4096
CONFIG_NET_LOG=y

# Heap and stacks
CONFIG_HEAP_MEM_POOL_SIZE=4096
CONFIG_MAIN_STACK_SIZE=4096
CONFIG_SYSTEM_WORKQUEUE_STACK_SIZE=2048

# MCUBOOT
CONFIG_BOOTLOADER_MCUBOOT=y
CONFIG_IMG_MANAGER=y
CONFIG_MCUBOOT_IMG_MANAGER=y
CONFIG_IMG_ERASE_PROGRESSIVELY=y

# Settings - Used to store real-time device configuration to flash.
CONFIG_SETTINGS=y
CONFIG_SETTINGS_FCB=y
CONFIG_FCB=y

# Non-volatile Storage
CONFIG_NVS=y

# Enable the LittleFS file system.
CONFIG_FILE_SYSTEM=y
CONFIG_FILE_SYSTEM_LITTLEFS=y

# Enable statistics and statistic names.
CONFIG_STATS=y
CONFIG_STATS_NAMES=y

# Disable boot banner. printk outputs get dropped w/ usbcdc
CONFIG_BOOT_BANNER=n

# Enable mcumgr.
CONFIG_MCUMGR=y

# Enable most core commands.
CONFIG_MCUMGR_CMD_IMG_MGMT=y
CONFIG_MCUMGR_CMD_OS_MGMT=y
CONFIG_MCUMGR_CMD_STAT_MGMT=y

# enable storage erase for mcumgr (needed for OTA for BLE)
CONFIG_MCUMGR_GRP_ZEPHYR_BASIC=y
CONFIG_MCUMGR_GRP_BASIC_CMD_STORAGE_ERASE=y

# Enable file system commands
CONFIG_MCUMGR_CMD_FS_MGMT=y

# CJSON
CONFIG_CJSON_LIB=y

# Peripherals
CONFIG_ADC=y
CONFIG_ADC_MODULES_SAMPLE_RATE_MSEC=30000
CONFIG_ADC_MODULES=y
CONFIG_BQ24195=y
CONFIG_PCF85263=y
CONFIG_DS18B20_TIMER=y

# GUI over LED
CONFIG_UI_MODULE=y
CONFIG_UI_LED_USE_PWM=y
CONFIG_UI_LOG_LEVEL_DBG=y

# Bluetooth
CONFIG_BT=y
CONFIG_BT_CTLR=y

# Partition Manager
CONFIG_PM_PARTITION_SIZE_LITTLEFS=0x180000
CONFIG_PM_PARTITION_REGION_LITTLEFS_EXTERNAL=y

# UART configure
CONFIG_UART_CONSOLE=y
CONFIG_CONSOLE=y

# Compiler
CONFIG_DEBUG_OPTIMIZATIONS=y
```

## boards/etc_flex_nrf52840.conf
```kconfig
# Enable LOG
CONFIG_LOG=y
CONFIG_LOG_BUFFER_SIZE=4096

# Heap and stacks
CONFIG_HEAP_MEM_POOL_SIZE=4096
CONFIG_MAIN_STACK_SIZE=4096
CONFIG_SYSTEM_WORKQUEUE_STACK_SIZE=2048

# Settings - Used to store real-time device configuration to flash.
CONFIG_SETTINGS=y
CONFIG_SETTINGS_FCB=y
CONFIG_FCB=y

# Non-volatile Storage
CONFIG_NVS=y

# Enable statistics and statistic names.
CONFIG_STATS=y
CONFIG_STATS_NAMES=y

# Disable boot banner. printk outputs get dropped w/ usbcdc
CONFIG_BOOT_BANNER=n

# CJSON
CONFIG_CJSON_LIB=y

# Peripherals
CONFIG_ADC=y
CONFIG_ADC_MODULES_SAMPLE_RATE_MSEC=30000
CONFIG_ADC_MODULES=y
CONFIG_BQ24195=y
CONFIG_PCF85263=y
CONFIG_DS18B20_TIMER=y

# GUI over LED
CONFIG_UI_MODULE=y
CONFIG_UI_LED_USE_PWM=y
CONFIG_UI_LOG_LEVEL_DBG=y

# Partition Manager
CONFIG_PM_PARTITION_SIZE_LITTLEFS=0x180000
CONFIG_PM_PARTITION_REGION_LITTLEFS_EXTERNAL=y

# Enable Shell
CONFIG_SHELL=y

# Enable uart console
CONFIG_UART_CONSOLE=y
CONFIG_USB_COMPOSITE_DEVICE=y
CONFIG_USB_DEVICE_STACK=y
CONFIG_USB_DEVICE_INITIALIZE_AT_BOOT=y
CONFIG_SHELL_BACKEND_SERIAL_CHECK_DTR=y
CONFIG_UART_LINE_CTRL=y
CONFIG_SHELL_BACKEND_SERIAL_INIT_PRIORITY=51
CONFIG_SHELL_PROMPT_UART="etc:~$ "

# Enable Network
CONFIG_NETWORKING=y
CONFIG_NET_NATIVE=n

CONFIG_NET_TX_STACK_SIZE=2048
CONFIG_NET_RX_STACK_SIZE=2048

CONFIG_NET_PKT_RX_COUNT=10
CONFIG_NET_PKT_TX_COUNT=10
CONFIG_NET_BUF_RX_COUNT=20
CONFIG_NET_BUF_TX_COUNT=20
CONFIG_NET_MAX_CONTEXTS=10
CONFIG_NET_IPV4=y
CONFIG_NET_IPV6=n
CONFIG_NET_SOCKETS_OFFLOAD=y
CONFIG_NET_TCP=y
CONFIG_NET_LOG=y
CONFIG_INIT_STACKS=y

CONFIG_NET_SHELL=y

# Enable Modem
CONFIG_MODEM=y
CONFIG_MODEM_SHELL=y
CONFIG_MODEM_QUECTEL_BG95_M3=y
CONFIG_MODEM_LOG_LEVEL_DBG=y
CONFIG_MODEM_CONTEXT_VERBOSE_DEBUG=y

# Sockets
CONFIG_NET_SOCKETS=y
CONFIG_NET_SOCKETS_POSIX_NAMES=y
CONFIG_NET_SOCKETS_POLL_MAX=4
```

## src/main.c
```c
#include <zephyr/kernel.h>
#include <stdio.h>
#include <stdlib.h>
#include <zephyr/drivers/gpio.h>
#include <zephyr/usb/usb_device.h>
#include <app_version.h>
#include <zephyr/drivers/hwinfo.h>
#include <zephyr/sys/reboot.h>
#include <zephyr/net/socket.h>
#include <errno.h>
#include <zephyr/net/tls_credentials.h>

#include <zephyr/logging/log.h>
LOG_MODULE_REGISTER(main, CONFIG_ETC_APP_LOG_LEVEL);

#define NET_CONFIG_PEER_IPV4_ADDR "142.93.158.106"
#define NET_CONFIG_PEER_IPV6_ADDR "2604:a880:cad:d0::de9:1001"
#define NET_PORT 8080
#define NET_IPPROTO IPPROTO_DTLS_1_2

struct pollfd sock_fds[1];


static int socket_recv_message(int sock_fd)
{
	static uint8_t in_buf[NET_IPV6_MTU];
	socklen_t from_addr_len;
	ssize_t len;
	static struct sockaddr from_addr;

	from_addr_len = sizeof(from_addr);
	len = recvfrom(sock_fd, in_buf, sizeof(in_buf) - 1, 0, &from_addr,
		       &from_addr_len);

	if (len < 0) {
		LOG_ERR("Error reading response: %d", errno);
		if (errno == EAGAIN || errno == EWOULDBLOCK) {
			return -errno;
		}
		return -errno;
	}

	if (len == 0) {
		LOG_ERR("Zero length recv");
		return 0;
	}

	LOG_DBG("received %d bytes", len);
	//LOG_HEXDUMP_DBG(in_buf, len, "SOCK_RECV");

	return 0;
}

void main(void)
{
	int sock;
	int ret = 0;
	struct sockaddr_in addr4;
	struct sockaddr_in addr6;
	struct sockaddr *addr = (struct sockaddr *)&addr4;
	addr4.sin_family = AF_INET;
	addr4.sin_port = htons(NET_PORT);
	inet_pton(AF_INET, NET_CONFIG_PEER_IPV4_ADDR, &addr4.sin_addr);

	sock = socket(addr->sa_family, SOCK_DGRAM, NET_IPPROTO);
	if (sock < 0) {
		LOG_ERR("Failed to create UDP socket %d", -errno);
		return;
	}
	
#if CONFIG_NATIVE_TLS
	int tls_native = 1;
	setsockopt(sock, SOL_TLS, TLS_NATIVE, &tls_native, sizeof(tls_native));

	static unsigned char client_psk[
				(sizeof(CONFIG_MODEM_QUECTEL_BG95_M3_PSK_KEY) - 1) / 2];
	static const char client_psk_id[] = CONFIG_MODEM_QUECTEL_BG95_M3_PSK_ID;
	hex2bin(CONFIG_MODEM_QUECTEL_BG95_M3_PSK_KEY, 
			sizeof(CONFIG_MODEM_QUECTEL_BG95_M3_PSK_KEY) - 1,
			client_psk, sizeof(client_psk));

	tls_credential_add(1, TLS_CREDENTIAL_PSK, client_psk,
					sizeof(client_psk));
	tls_credential_add(1, TLS_CREDENTIAL_PSK_ID, client_psk_id,
					sizeof(client_psk_id) - 1);
#endif


	LOG_INF("Socket is ready %d", sock);
	/* Call connect so we can use send and recv. */
	ret = connect(sock, addr, sizeof(addr4));
	if (ret < 0) {
		LOG_ERR("Cannot connect to UDP remote %d", -errno);
		ret = -errno;
	}

	LOG_INF("Connected success to %s:%d", NET_CONFIG_PEER_IPV4_ADDR, NET_PORT);
	uint8_t msg[] = "Hello, world!\r\n";
	ret = send(sock, msg, strlen(msg), 0);
	if (ret < 0) {
		LOG_ERR("Failed to send UDP message %d", -errno);
	}
	k_sleep(K_SECONDS(1));


	sock_fds[0].fd = sock;
	sock_fds[0].events = POLLIN;
	while (1) {
		ret = poll(sock_fds, 1, 5000);
		if (ret < 0) {
			LOG_ERR("Error in poll:%d", errno);
			errno = 0;
			k_sleep(K_SECONDS(1));
			continue;
		}

		if ((sock_fds[0].revents & POLLERR) || (sock_fds[0].revents & POLLNVAL) ||
			(sock_fds[0].revents & POLLHUP)) {
			LOG_ERR("Poll reported a socket error, %02x.", sock_fds[0].revents);
			continue;
		}

		if (sock_fds[0].revents & POLLIN) {
			while (sock) {
				ret = socket_recv_message(sock);
				if (ret) {
					break;
				}
			}
		}
	}


	/* Close socket. */
	ret = close(sock);
	if (ret < 0) {
		LOG_ERR("Failed to close socket %d", -errno);
	}
	
#if 0
	addr = (struct sockaddr *)&addr6;
	addr6.sin_family = AF_INET6;
	addr6.sin_port = htons(NET_PORT);
	inet_pton(AF_INET6, NET_CONFIG_PEER_IPV6_ADDR, &addr6.sin_addr);
	sock = socket(addr->sa_family, SOCK_DGRAM, NET_IPPROTO);
	if (sock < 0) {
		LOG_ERR("Failed to create UDP socket %d", -errno);
		return;
	}

	LOG_INF("Socket is ready %d", sock);
	/* Call connect so we can use send and recv. */
	ret = connect(sock, addr, sizeof(addr4));
	if (ret < 0) {
		LOG_ERR("Cannot connect to UDP v6 remote %d", -errno);
		ret = -errno;
	}

	LOG_INF("Connected success to %s:%d", NET_CONFIG_PEER_IPV6_ADDR, NET_PORT);
	uint8_t msgv6[] = "Hello, world v6!\r\n";
	ret = send(sock, msgv6, strlen(msgv6), 0);
	if (ret < 0) {
		LOG_ERR("Failed to send UDP message %d", -errno);
	}

	ret = close(sock);
	if (ret < 0) {
		LOG_ERR("Failed to close socket %d", -errno);
	}
#endif

	while (true) {
		k_sleep(K_SECONDS(1));
	}
}
```
