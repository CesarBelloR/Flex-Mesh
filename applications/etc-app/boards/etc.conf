## applications/etc-app/boards/etc.conf
```kconfig
# Network
CONFIG_NETWORKING=y
CONFIG_NET_SOCKETS=y
CONFIG_NET_SOCKETS_OFFLOAD=y
CONFIG_NET_NATIVE=n
CONFIG_NET_IPV4=y
CONFIG_NET_IPV6=n


CONFIG_MODEM=y
CONFIG_MODEM_QUECTEL_BG95_M3=y
CONFIG_MODEM_LOG_LEVEL_DBG=n
CONFIG_MODEM_CONTEXT_VERBOSE_DEBUG=n

CONFIG_LOG=y
CONFIG_ETC_APP_LOG_LEVEL_DBG=y
CONFIG_LOG_BUFFER_SIZE=4096
CONFIG_NET_LOG=y

# Heap and stacks
CONFIG_HEAP_MEM_POOL_SIZE=4096
CONFIG_MAIN_STACK_SIZE=4096
CONFIG_SYSTEM_WORKQUEUE_STACK_SIZE=2048

# MCUBOOT
CONFIG_BOOTLOADER_MCUBOOT=y
CONFIG_IMG_MANAGER=y
CONFIG_MCUBOOT_IMG_MANAGER=y
CONFIG_IMG_ERASE_PROGRESSIVELY=y

# Settings - Used to store real-time device configuration to flash.
CONFIG_SETTINGS=y
CONFIG_SETTINGS_FCB=y
CONFIG_FCB=y

# Non-volatile Storage
CONFIG_NVS=y

# Enable the LittleFS file system.
CONFIG_FILE_SYSTEM=y
CONFIG_FILE_SYSTEM_LITTLEFS=y

# Enable statistics and statistic names.
CONFIG_STATS=y
CONFIG_STATS_NAMES=y

# Disable boot banner. printk outputs get dropped w/ usbcdc
CONFIG_BOOT_BANNER=n

# Enable mcumgr.
CONFIG_MCUMGR=y

# Enable most core commands.
CONFIG_MCUMGR_CMD_IMG_MGMT=y
CONFIG_MCUMGR_CMD_OS_MGMT=y
CONFIG_MCUMGR_CMD_STAT_MGMT=y

# enable storage erase for mcumgr (needed for OTA for BLE)
CONFIG_MCUMGR_GRP_ZEPHYR_BASIC=y
CONFIG_MCUMGR_GRP_BASIC_CMD_STORAGE_ERASE=y

# Enable file system commands
CONFIG_MCUMGR_CMD_FS_MGMT=y

# CJSON
CONFIG_CJSON_LIB=y

# Peripherals
CONFIG_ADC=y
CONFIG_ADC_MODULES_SAMPLE_RATE_MSEC=30000
CONFIG_ADC_MODULES=y
CONFIG_BQ24195=y
CONFIG_PCF85263=y
CONFIG_DS18B20_TIMER=y

# GUI over LED
CONFIG_UI_MODULE=y
CONFIG_UI_LED_USE_PWM=y
CONFIG_UI_LOG_LEVEL_DBG=y

# Bluetooth
CONFIG_BT=y
CONFIG_BT_CTLR=y

# Partition Manager
CONFIG_PM_PARTITION_SIZE_LITTLEFS=0x180000
CONFIG_PM_PARTITION_REGION_LITTLEFS_EXTERNAL=y
```

## applications/etc-app/boards/etc_0_3_0.conf
```kconfig
CONFIG_W1=y
CONFIG_EXACT_DS2484=y
CONFIG_ONEWIRE_I2C=y
CONFIG_ONEWIRE_I2C_LOG_LEVEL_INF=y
CONFIG_SENSOR=y
CONFIG_SHT31=y
CONFIG_SENSOR_LOG_LEVEL_DBG=y
CONFIG_SHT3XD_SINGLE_SHOT_MODE=y
```

## applications/etc-app/boards/etc_flex_nrf52840.conf
```kconfig
# Network
CONFIG_NETWORKING=y
CONFIG_NET_NATIVE=n
CONFIG_NET_IPV4=y
CONFIG_NET_IPV6=n
CONFIG_NRF_MODEM_LIB=n
CONFIG_NET_LOG=y

CONFIG_MODEM=y
CONFIG_MODEM_QUECTEL_BG95_M3=y
CONFIG_MODEM_QUECTEL_BG95_M3_APN="iot.1nce.net"
CONFIG_MODEM_QUECTEL_BG95_PSM_AUTO=y
CONFIG_MODEM_CMD_HANDLER_MAX_PARAM_COUNT=9
CONFIG_NET_SOCKETS_OFFLOAD=y
# Increase modem connection timeout to 10 minutes. Can be tightened later after testing.
CONFIG_MODEM_MODULE_MAX_CONNECTION_TIME_S=600
# CONFIG_NET_SOCKETS_SOCKOPT_TLS is not required with Zephyr versions >=3.0
# when using offloaded sockets.
# CONFIG_NET_SOCKETS_SOCKOPT_TLS=y
# CONFIG_NET_SOCKETS_OFFLOAD_TLS=y

CONFIG_LOG_BUFFER_SIZE=4096

# Heap and stacks
CONFIG_HEAP_MEM_POOL_SIZE=8192
CONFIG_MAIN_STACK_SIZE=4096
CONFIG_SYSTEM_WORKQUEUE_STACK_SIZE=4096

# MCUBOOT
CONFIG_BOOTLOADER_MCUBOOT=y
CONFIG_IMG_MANAGER=y
CONFIG_MCUBOOT_IMG_MANAGER=y
CONFIG_IMG_ERASE_PROGRESSIVELY=y

# Settings - Used to store real-time device configuration to flash.
CONFIG_SETTINGS=y
CONFIG_SETTINGS_FCB=y
CONFIG_FCB=y

# Non-volatile Storage
CONFIG_NVS=y

# Enable statistics and statistic names.
CONFIG_STATS=y
CONFIG_STATS_NAMES=y

# Disable boot banner. printk outputs get dropped w/ usbcdc
CONFIG_BOOT_BANNER=n

# Enable mcumgr.
CONFIG_MCUMGR=y

# Enable most core commands.
CONFIG_MCUMGR_GRP_IMG=y
CONFIG_MCUMGR_GRP_OS=y
CONFIG_MCUMGR_GRP_STAT=y
CONFIG_MCUMGR_GRP_SHELL=y
CONFIG_MCUMGR_TRANSPORT_UART=y
CONFIG_MCUMGR_TRANSPORT_SHELL=y
CONFIG_MCUMGR_GRP_IMG_LOG_LEVEL_DBG=y
CONFIG_MCUMGR_GRP_IMG_STATUS_HOOKS=y
CONFIG_MCUMGR_SMP_COMMAND_STATUS_HOOKS=y
CONFIG_MCUMGR_MGMT_NOTIFICATION_HOOKS=y
# Dummy shell backend is required for TRANSPORT_SHELL mcumgr option
CONFIG_SHELL_BACKEND_DUMMY=y

# Enable MCUMGR for ETC
CONFIG_MCUMGR_CMD_ETC_MGMT=y

# enable storage erase for mcumgr (needed for OTA for BLE)
CONFIG_MCUMGR_GRP_ZBASIC=y
CONFIG_MCUMGR_GRP_ZBASIC_STORAGE_ERASE=y

CONFIG_MCUMGR_TRANSPORT_BT=y
CONFIG_MCUMGR_TRANSPORT_BT_AUTHEN=n
CONFIG_MCUMGR_TRANSPORT_BT_CONN_PARAM_CONTROL=y

# CJSON
CONFIG_CJSON_LIB=y

# Peripherals
CONFIG_ADC=y
CONFIG_ADC_MODULES=y
CONFIG_PCF85263=y
CONFIG_DS18B20_TIMER=y

# GUI over LED
CONFIG_UI_MODULE=y
CONFIG_UI_LED_USE_PWM=y

# Partition Manager
CONFIG_PM_OVERRIDE_EXTERNAL_DRIVER_CHECK=y
CONFIG_PM_PARTITION_REGION_SETTINGS_STORAGE_EXTERNAL=n
CONFIG_PM_PARTITION_REGION_NVS_STORAGE_EXTERNAL=y

# PMIC
CONFIG_SENSOR=y
CONFIG_BQ25618=y

# Shell interface
CONFIG_SHELL=y
CONFIG_SHELL_BACKEND_SERIAL=y
CONFIG_SHELL_BACKEND_DUMMY_BUF_SIZE=512
CONFIG_DATE_SHELL=n
CONFIG_FLASH_SHELL=n
# HW Interface
CONFIG_ETC_INTERFACE=y

# ETC Settings
CONFIG_ETC_SETTINGS=y

# LoRa config
CONFIG_LORA=y
CONFIG_LORA_SX127X=y
CONFIG_ETC_LORA_MODULE=y

# Enable Power Management module
CONFIG_PM=y
CONFIG_PM_DEVICE=y
CONFIG_PM_DEVICE_RUNTIME=y

# GNSS configuration
CONFIG_GNSS=y
CONFIG_GNSS_DUMP_TO_LOG=y
CONFIG_GNSS_PARSE=y

CONFIG_MODEM_QUECTEL_BG95_M3_GNSS=y
CONFIG_MODEM_QUECTEL_BG95_M3_GNSS_SHELL=y

# Enable GPIO Hogs
CONFIG_GPIO_HOGS=y
CONFIG_GPIO_HOGS_INIT_PRIORITY=70
```

## applications/etc-app/boards/etc_v0_2.conf
```kconfig
# Network
CONFIG_NETWORKING=y
CONFIG_NET_NATIVE=n
CONFIG_NET_IPV4=y
CONFIG_NET_IPV6=n
CONFIG_NRF_MODEM_LIB=n
CONFIG_NET_LOG=y

CONFIG_MODEM=y
CONFIG_MODEM_QUECTEL_BG95_M3=y
CONFIG_MODEM_QUECTEL_BG95_M3_APN="teal"
CONFIG_MODEM_QUECTEL_BG95_PSM=y
CONFIG_MODEM_CMD_HANDLER_MAX_PARAM_COUNT=9
CONFIG_NET_SOCKETS_OFFLOAD=y
# CONFIG_NET_SOCKETS_SOCKOPT_TLS is not required with Zephyr versions >=3.0
# when using offloaded sockets.
# CONFIG_NET_SOCKETS_SOCKOPT_TLS=y
# CONFIG_NET_SOCKETS_OFFLOAD_TLS=y

CONFIG_LOG=y
CONFIG_LOG_BUFFER_SIZE=4096
CONFIG_NET_LOG=y

# Heap and stacks
CONFIG_HEAP_MEM_POOL_SIZE=8192
CONFIG_MAIN_STACK_SIZE=4096
CONFIG_SYSTEM_WORKQUEUE_STACK_SIZE=4096

# MCUBOOT
CONFIG_BOOTLOADER_MCUBOOT=y
CONFIG_IMG_MANAGER=y
CONFIG_MCUBOOT_IMG_MANAGER=y
CONFIG_IMG_ERASE_PROGRESSIVELY=y

# Settings - Used to store real-time device configuration to flash.
CONFIG_SETTINGS=y
CONFIG_SETTINGS_FCB=y
CONFIG_FCB=y

# Non-volatile Storage
CONFIG_NVS=y

# Enable statistics and statistic names.
CONFIG_STATS=y
CONFIG_STATS_NAMES=y

# Disable boot banner. printk outputs get dropped w/ usbcdc
CONFIG_BOOT_BANNER=n

# Enable mcumgr.
CONFIG_MCUMGR=y

# Enable most core commands.
CONFIG_MCUMGR_CMD_IMG_MGMT=y
CONFIG_MCUMGR_CMD_OS_MGMT=y
CONFIG_MCUMGR_CMD_STAT_MGMT=y
CONFIG_MCUMGR_CMD_SHELL_MGMT=y
CONFIG_MCUMGR_SMP_UART=y
CONFIG_MCUMGR_SMP_SHELL=y

# Enable MCUMGR for ETC
CONFIG_MCUMGR_CMD_ETC_MGMT=y

# enable storage erase for mcumgr (needed for OTA for BLE)
CONFIG_MCUMGR_GRP_ZEPHYR_BASIC=y
CONFIG_MCUMGR_GRP_BASIC_CMD_STORAGE_ERASE=y

# CJSON
CONFIG_CJSON_LIB=y

# Peripherals
CONFIG_ADC=y
CONFIG_ADC_MODULES_SAMPLE_RATE_MSEC=30000
CONFIG_ADC_MODULES=y
CONFIG_PCF85263=y
CONFIG_DS18B20_TIMER=y

# GUI over LED
CONFIG_UI_MODULE=y
CONFIG_UI_LED_USE_PWM=y

# Bluetooth
# CONFIG_BT=y
# CONFIG_BT_CTLR=y

# Partition Manager
CONFIG_PM_OVERRIDE_EXTERNAL_DRIVER_CHECK=y
CONFIG_PM_PARTITION_REGION_SETTINGS_STORAGE_EXTERNAL=y
CONFIG_PM_PARTITION_REGION_NVS_STORAGE_EXTERNAL=y

# PMIC
CONFIG_SENSOR=y
CONFIG_BQ25618=y

# Shell interface
CONFIG_SHELL=y
CONFIG_SHELL_BACKEND_SERIAL=n
CONFIG_SHELL_BACKEND_DUMMY_BUF_SIZE=512
CONFIG_DATE_SHELL=n
# HW Interface
CONFIG_ETC_INTERFACE=y

# ETC Settings
CONFIG_ETC_SETTINGS=y

# LoRa config
CONFIG_LORA=y
CONFIG_LORA_SX12XX=y
CONFIG_ETC_LORA_MODULE=y

# Enable Power Management module
CONFIG_PM=y
CONFIG_PM_DEVICE=y
```

## applications/etc-app/src/cloud/Kconfig
```kconfig
#
# Copyright (c) 2022 EXACT Technology
#

module = CLOUD_INTEGRATION
module-str = Cloud integration layer
source "subsys/logging/Kconfig.template.log_config"
```

## applications/etc-app/src/cloud/Kconfig.lwm2m
```kconfig
#
# Copyright (c) 2022 Nordic Semiconductor
#
# Copyright (c) 2023 EXACT Technology Corporation
#

module = LWM2M_INTEGRATION
module-prompt = "LwM2M integration"

config $(module)
	bool
	prompt "LwM2M integration layer"

if LWM2M_INTEGRATION

menu "LwM2M integration library"

choice
	prompt "Select the unique ID that should be used for the endpoint identification"
	default LWM2M_INTEGRATION_ENDPOINT_HWINFO

config LWM2M_INTEGRATION_ENDPOINT_HWINFO
	bool "Use the nRF52 HW info (64-bit MAC) for endpoint identification"

config LWM2M_INTEGRATION_ENDPOINT_SERIALNUMBER
	bool "Use the EXACT assigned serial number for endpoint identification"

endchoice

config LWM2M_INTEGRATION_ENDPOINT_PREFIX
	string "LwM2M endpoint prefix"
	default "urn:dev:mac:" if LWM2M_INTEGRATION_ENDPOINT_HWINFO
	default "urn:dev:os:60606-" if LWM2M_INTEGRATION_ENDPOINT_SERIALNUMBER

config LWM2M_INTEGRATION_PSK_ID
	string "LwM2M PSK"
	default MODEM_QUECTEL_BG95_M3_PSK_ID
	help
	  LwM2M PSK ID to be used. Defaults to ID configured
	  for modem.
	

config LWM2M_INTEGRATION_PSK
	string "LwM2M PSK"
	default MODEM_QUECTEL_BG95_M3_PSK_KEY
	help
	  LwM2M PSK key to be used. Defaults to key configured
	  for modem.

# Make AVsystem the default lwM2M server.
config LWM2M_INTEGRATION_SERVER_URL
	string "LwM2M server address"
	default "coaps://eu.iot.avsystem.cloud:5684"
	help
	  Kconfig redefinition, please see the help text of the original definition.

config LWM2M_INTEGRATION_MAX_HUMID_SENSOR_INSTANCE_COUNT
	int "Maximum # of EXACT Humidity Sensor object instances"
	default 1
	help
	  This setting establishes the total count of EXACT Humidity
	  Sensor instances available to the LWM2M client.


config LWM2M_INTEGRATION_FIRMWARE_UPDATE_OBJ_SUPPORT
	bool "Firmware Update object support"
	default y
	select LWM2M_FIRMWARE_UPDATE_OBJ_SUPPORT if (!ZTEST)
	select DFU_TARGET
	select BOOTLOADER_MCUBOOT if !ZTEST
	select IMG_MANAGER if !ZTEST
	select IMG_ERASE_PROGRESSIVELY if !ZTEST
	select FLASH if !ZTEST
	select STREAM_FLASH if !ZTEST
	select MPU_ALLOW_FLASH_WRITE if !ZTEST
	select FOTA_DOWNLOAD_PROGRESS_EVT if FOTA_DOWNLOAD

rsource "lwm2m/exact_objects/Kconfig"

if LWM2M_INTEGRATION_FIRMWARE_UPDATE_OBJ_SUPPORT

config LWM2M_INTEGRATION_MCUBOOT_FLASH_BUF_SIZE
	int "Size of buffer used for flash write operations during MCUboot updates"
	depends on DFU_TARGET_MCUBOOT
	default 512
	help
	  Buffer size must be aligned to the minimal flash write block size.

endif # LWM2M_INTEGRATION_FIRMWARE_UPDATE_OBJ_SUPPORT

endmenu

endif # LWM2M_INTEGRATION
```

## applications/etc-app/src/cloud/cloud_codec/Kconfig
```kconfig
#
# Copyright (c) 2021 Nordic Semiconductor
#
# SPDX-License-Identifier: LicenseRef-Nordic-5-Clause
#

menuconfig CLOUD_CODEC
	bool "Application cloud codec"
	default y

if CLOUD_CODEC

choice
	prompt "Application cloud codec backend"
	default CLOUD_CODEC_LWM2M if LWM2M
	default CLOUD_CODEC_AWS_IOT if AWS_IOT

config CLOUD_CODEC_AWS_IOT
	bool "Enable AWS IoT codec backend"

config CLOUD_CODEC_LWM2M
	bool "Enable lwM2M codec backend"

endchoice

config CLOUD_CODEC_LWM2M_PATH_LIST_ENTRIES_MAX
	int "Maximum size of path list"
	default LWM2M_COMPOSITE_PATH_LIST_SIZE if LWM2M
	default 1
	help
	  Maximum number of entries in the path list constructed when writing to objects.

config CLOUD_CODEC_APN_LEN_MAX
	int "Maximum length of APN"
	default 30
	help
	  Maximum length of APN (Access Point Name).

config CLOUD_CODEC_MANUFACTURER
	string "Manufacturer name"
	default "EXACT Technology"

config CLOUD_CODEC_MODEL
	string "Model name"
	default "Monitor 2.0"

config CLOUD_CODEC_DEVICE_TYPE
	string "Model name"
	default "M2"

if LWM2M_IPSO_HUMIDITY_SENSOR
choice LWM2M_IPSO_HUMIDITY_SENSOR_VERSION
	default LWM2M_IPSO_HUMIDITY_SENSOR_VERSION_1_1
endchoice
endif # LWM2M_IPSO_HUMIDITY_SENSOR

if LWM2M_IPSO_TEMP_SENSOR
choice LWM2M_IPSO_TEMP_SENSOR_VERSION
	default LWM2M_IPSO_TEMP_SENSOR_VERSION_1_1
endchoice
endif # LWM2M_IPSO_TEMP_SENSOR

module = CLOUD_CODEC
module-str = Cloud codec
source "subsys/logging/Kconfig.template.log_config"

endif # CLOUD_CODEC #
```

## applications/etc-app/src/cloud/lwm2m/exact_objects/Kconfig
```kconfig
#
# Copyright (c) 2022 Nordic Semiconductor
#
# Copyright (c) 2023 EXACT Technology Corporation
#

if LWM2M_INTEGRATION

menu "LwM2M ETC objects"

config LWM2M_ETC_RELAY_OBJ_DATA_SIZE
	int "Size of the relay object's data resource"
	default 512
	help
	  Size of the relay object's data resource. This is used to forward
	  relay data recorded from a LoRa logger through LwM2M.

config LWM2M_ETC_RELAY_OBJ_COMMAND_SIZE
	int "Size of the relay object's command resource"
	default 128
	help
	  Size of the relay object's command resource. This is used by the portal
	  to forward commands to an end device that is connected over LoRa.

endmenu

endif # LWM2M_INTEGRATION
```

## applications/etc-app/src/exact/Kconfig
```kconfig
menu "EXACT Services and Libraries"
rsource "etc_data_fs/Kconfig"
rsource "etc_date_time/Kconfig"
rsource "etc_interface/Kconfig"
rsource "etc_settings/Kconfig"
rsource "etc_devices/Kconfig"
rsource "etc_sensor/Kconfig"
rsource "watchdog/Kconfig"
rsource "etc_devices/Kconfig"
rsource "etc_mgmt/Kconfig"
rsource "etc_ntc_db/Kconfig"
rsource "etc_memfault/Kconfig"
rsource "etc_battery/Kconfig"
endmenu
```

## applications/etc-app/src/exact/etc_battery/Kconfig
```kconfig
menuconfig ETC_BATTERY
	bool "Battery management"
	default y
	depends on BQ25618

if ETC_BATTERY

config BATTERY_LOW_VOLTAGE_MV
	int "The voltage in mV to determine battery in low power"
	default 3450

config BATTERY_NOT_INSTALL_MV
	int "The voltage in mV to determine battery in not installed"
	default 2800

config BATTERY_MODULE_SHELL
	bool "Enable battery module shell for testing"
	depends on SHELL
	default n

module = ETC_BATTERY
module-str = battery
source "subsys/logging/Kconfig.template.log_config"

endif
```

## applications/etc-app/src/exact/etc_ble/Kconfig
```kconfig
menuconfig ETC_BLE
	bool "BLE for Flex device"
	default y
	help
        	Selection for BLE feature

if ETC_BLE

config ETC_BLE_ENCRYPTION
	bool "Enable/disable the encryption data for BLE module"
	default n

config ETC_BLE_ADV_MAGNET_TIMEOUT_SEC
	int "Timeout in seconds for magnet advertise"
	default  120
	
config ETC_BLE_PAYLOAD_LEGACY_FORMAT
	bool "Enabe/disable the format payload"
	default y

config ETC_BLE_ADV_WATCH_PERIOD_SEC
	int "Period in seconds of the check that restarts a silently stopped advertiser"
	default 60

config ETC_BLE_TEST_SHELL
	bool "Shell commands that break BLE state for HIL tests"
	depends on SHELL

module = ETC_BLE
module-str = ble
source "subsys/logging/Kconfig.template.log_config"

endif
```
