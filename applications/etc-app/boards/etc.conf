## applications/etc-app/src/exact/etc_calibration/Kconfig
```kconfig
menuconfig ETC_CALIBRATION
	bool "Calibration for Flex device"
	default y
	depends on TMP1826

if ETC_CALIBRATION

config CALIBRATION_MODULE_SHELL
	bool "Enable calibration module shell for testing"
	depends on SHELL
	default n

config CALIBRATION_TIMEOUT
    int "Calibration timeout in seconds"
    default 30
    help
        Time in seconds after which calibration will abort if cloud connection
        cannot be established. When timeout occurs, LED will blink red.

config TEMP_RANGE_SPECIFIC_MIN
    int "Specific Range Minimum (centidegrees C)"
    default 1800
    help
        Minimum value for the specific temperature range (in centidegrees C)

config TEMP_RANGE_SPECIFIC_MAX
    int "Specific Range Maximum (centidegrees C)"
    default 2800
    help
        Maximum value for the specific temperature range (in centidegrees C)

config TEMP_RANGE_SWITCH2_REF
    int "Switch 2 Temperature Reference (centidegrees C)"
    default 20
    help
        Reference value for switch 2 temperature range (in centidegrees C)

config TEMP_RANGE_SWITCH3_REF
    int "Switch 3 Temperature Reference (centidegrees C)"
    default 2500
    help
        Reference value for switch 3 temperature range (in centidegrees C)

config TEMP_RANGE_SWITCH4_REF
    int "Switch 4 Temperature Reference (centidegrees C)"
    default 4460
    help
        Reference value for switch 4 temperature range (in centidegrees C)

config TEMP_RANGE_SWITCH5_REF
    int "Switch 5 Temperature Reference (centidegrees C)"
    default 7040
    help
        Reference value for switch 5 temperature range (in centidegrees C)

config TEMP_TOLERANCE
    int "Temperature Tolerance (centidegrees C)"
    default 24
    help
        Tolerance value applied to switch temperature ranges (in centidegrees C)

module = ETC_CALIBRATION
module-str = calibration
source "subsys/logging/Kconfig.template.log_config"

endif
```

## applications/etc-app/src/exact/etc_data_fs/Kconfig
```kconfig
# Copyright (c) 2021 Nordic Semiconductor ASA
# SPDX-License-Identifier: Apache-2.0

menuconfig ETC_DATA_FS
	bool "Service to store data to flash"
	select FILE_SYSTEM
	select FILE_SYSTEM_LITTLEFS
	help
	  Enable data sensor file system logging

if ETC_DATA_FS

config DATA_FS_FILE_PREFIX
	string "Data Logging File Prefix"
	default "data."
	help
	  File name for saving data sensor events

config DATA_FS_DIR
	string "Data Logging Path"
	default "/lfs1/etc"
	help
	  Path name for saving data sensor events

config DATA_FS_FILE_SIZE
	int "Number of bytes for each file sensor"
	default 4096
	help
	  File sensor size

config DATA_FS_FILES_LIMIT
	int "Max number of files containing logs"
	default 10
	help
	  Limit of number of files with logs. It is also limited by
	  size of file system partition.

config DATA_FS_OVERWRITE
	bool "Old data sensor files overwrite"
	default y
	help
	  When enabled backend overwrites oldest log files.
	  In other case, when memory is full, new messages are dropped.

module = DATA_FS
module-str = data fs
source "subsys/logging/Kconfig.template.log_config"

endif
```

## applications/etc-app/src/exact/etc_devices/Kconfig
```kconfig
menuconfig ETC_DEVICE
	bool "Mode for ETC Monitor Device"
	default y
	help
	  Selection for ETC Monitor Device Mode (Relay or Logger)

if ETC_DEVICE

config ETC_DEVICE_MODE_RELAY
	int "Relay mode"
	default 1

config ETC_DEVICE_MODE_LOGGER
	int "Logger mode"
	default 2

config ETC_DEVICE_MODE
	int "ETC Device Mode Relay (1) or Logger (2)"
	default ETC_DEVICE_MODE_LOGGER

config ETC_DEVICE_RADIO_LTE
	int "Radio mode over LTE"
	default 0

config ETC_DEVICE_RADIO_LORA
	int "Radio mode over Lora"
	default 1

config ETC_DEVICE_RADIO_MODE
	int "ETC Radio Mode LTE (0) or Lora (1)"
	default ETC_DEVICE_RADIO_LORA

config ETC_DEVICE_SAVE_RECORD_SEC
	int "Number of seconds to save the header ACKs"
	default 3600

config ETC_DEVICE_RELAY_MAX_RECORD_HISTORY
	int "Maximum number of record that relay stores in ROM"
	default 64
	help
		Default value for number of record that the Relay can save in ROM.
		
config ETC_RECORD_TEST
	bool "Enable ETC Record Test"
	default n

config ETC_RECORD_MAX_PER_SECTOR
	int "Maximum ETC Records per Sector"
	depends on ETC_RECORD_TEST
	default 12
	help
	  This option sets the maximum number of ETC records per sector.

config ETC_RECORD_MAX_SECTOR
	int "Maximum Records Sector"
	depends on ETC_RECORD_TEST
	default 2
	help
	  This option sets the maximum number of ETC sectors to save record.
	  
choice ETC_RECORD_FORMAT_CHOICE
    prompt "Select Data Format"
    default ETC_RECORD_RAW
    help
        Select the data format to be used. Choose between the legacy format and the new format.

config ETC_RECORD_RAW
    bool "The old ETC format with structure in/out as normal structure"
    help
        Use the legacy data format.

config ETC_RECORD_CBOR
    bool "The new ETC format with structure encode/decode as CBOR"
    help
        Use the new data format.

endchoice

module = ETC_DEVICE
module-str = device
source "subsys/logging/Kconfig.template.log_config"

module = ETC_RELAY_RECLAIM
module-str = relay_reclaim
source "subsys/logging/Kconfig.template.log_config"

endif
```

## applications/etc-app/src/exact/etc_interface/Kconfig
```kconfig
menuconfig ETC_INTERFACE
	bool "HALL sensor or User button interface"
	select GPIO
	default y
	
if ETC_INTERFACE

config ETC_INTERFACE_TEST_SHELL
	bool "ETC interface test shell commands"
	depends on SHELL
	help
	  Adds shell commands to inject interface events (e.g. a HALL/magnet
	  swipe) for hardware-in-the-loop testing. Test/diagnostic use only.

module = ETC_INTERFACE
module-str = etc interface
source "subsys/logging/Kconfig.template.log_config"

endif # ETC_INTERFACE
```

## applications/etc-app/src/exact/etc_memfault/Kconfig
```kconfig
#
# Copyright (c) 2023 EXACT Technology
#

module = MEMFAULT_ETC

config $(module)
	bool
	depends on MEMFAULT
	prompt "Memfault ETC config"

if MEMFAULT_ETC

config MEMFAULT_ETC_FW_TYPE
	string "Firmware type"
	default "m2-fw"
	help
	  Firmware type running on the board

config MEMFAULT_ETC_DEVICE_ID_MAX_LEN
	int "Memfault device ID max length"
	default 30
	help
	  Maximum length for the device ID

config MEMFAULT_ETC_HW_VERSION_MAX_LEN
	int "Memfault HW version max length"
	default 10
	help
	  Maximum length for the hardware version

config MEMFAULT_ETC_HW_VERSION_PREFIX
	string "Prefix added onto device HW version"
	default "flex-"

config MEMFAULT_ETC_EVENT_NOINIT_SIZE
	int "Memfault Event Storage NoInit RAM Buffer Size"
	default 2048
	help
	 The no-init RAM area used to batch memfault events before they are flushed
	 to the Memfault Cloud.
	
module-dep = LOG
module-str = Memfault ETC module
source "${ZEPHYR_BASE}/subsys/logging/Kconfig.template.log_config"

endif # MEMFAULT
```

## applications/etc-app/src/exact/etc_mgmt/Kconfig
```kconfig
menuconfig MCUMGR_CMD_ETC_MGMT
	bool "Custom MCUMgrs Commands for the ETC"
	help
	  Enable custom commands for the ETC Monitor via/MCUMgr

module = ETC_MGMT
module-str = etc_mgmt
source "subsys/logging/Kconfig.template.log_config"
```

## applications/etc-app/src/exact/etc_ntc_db/Kconfig
```kconfig
menuconfig ETC_NTC_TABLE
	bool "Custom MCUMgrs Commands for the ETC"
	default y
	help
	  Enable the NTC Table Lookup for sensor converter

if ETC_NTC_TABLE
	config NTC_USE_OFFSET_1
		bool "Use NTC table with offset 1 deg in C"
		default y

endif
```

## applications/etc-app/src/exact/etc_sensor/Kconfig
```kconfig
menuconfig ETC_SENSOR
	bool "Ambient temperature sensor"
	default y
	help
	  The ambient temperature sensor library for application

if ETC_SENSOR

choice
	prompt "Select protocol to get ambient sensor"
	default ETC_AMBIENT_NTC_SENSOR

config ETC_AMBIENT_NTC_SENSOR
	bool "Select ambient with NTC sensor"
	depends on !TMP1075

config ETC_AMBIENT_I2C_SENSOR
	bool "Select ambient with I2C sensor"
	depends on TMP1075

endchoice

config ETC_SENSOR_TMP1826_GPIO_RETRIES
	int "Number of retries to set GPIO for TMP1826"
	default 3
	help
	  Number of retries to set GPIO for TMP1826.

config ETC_SENSOR_SIM_SHELL
	bool "Simulated sensor reading shell commands"
	depends on SHELL
	help
	  Adds shell commands (sensor_sim set/clear/status) that substitute
	  simulated readings into the sample before the sensor event is
	  submitted, so hardware-in-the-loop tests can drive a reading without
	  moving a physical probe. Test/diagnostic use only.

config ETC_SENSOR_HW_LOCK_TIMEOUT_S
	int "Timeout acquiring the analog front-end lock, in seconds"
	default 15
	help
	  How long etc_sensor_run_acquisition() waits for the front-end lock before
	  skipping the sample and returning -EBUSY. Must exceed the longest normal
	  calibration run, otherwise samples are dropped whenever a calibration
	  happens to overlap. Waiting forever here allowed a stuck acquisition to
	  park the sensor thread indefinitely.

module = ETC_SENSOR
module-str = etc sensor
source "subsys/logging/Kconfig.template.log_config"

endif # ETC_SENSOR
```

## applications/etc-app/src/exact/etc_settings/Kconfig
```kconfig
menuconfig ETC_SETTINGS
	bool "ETC Settings Library"
	help
	  Settings subsystem for ETC

if ETC_SETTINGS

config INTERVAL_TIME_MEASUREMENT_IN_SECONDS
	int "Interval time of measurement in seconds"
	default 900
	help
		Setting the interval time for measurement in default

config INTERVAL_TIME_TRANSMISSION_IN_SECONDS
	int "Interval time of transmission in seconds"
	default 900
	help
		Setting the interval time for transmission in default

config SERIAL_NUMBER_TYPE
	int "Select serial number concept by using HWInfo or EXACT Serial Number"
	default 1
	help
		Setting to select the serial from HW info (option 0) or EXACT Serial Number (1)

config SERIAL_NUMBER_DEFAULT_VALUE
	int "The default serial number"
	default 10000000
	help
		Default value for serial number when type is EXACT Serial Number

config RELAY_MAX_RECORD_HISTORY
	int "Maximum number of record that relay stores in ROM"
	default 240
	help
		Default value for number of record that the Relay can save in ROM.

module = ETC_SETTINGS
module-str = etc settings
source "subsys/logging/Kconfig.template.log_config"

endif
```

## applications/etc-app/src/exact/watchdog/Kconfig
```kconfig
#
# Copyright (c) 2021 Nordic Semiconductor
#
# SPDX-License-Identifier: LicenseRef-Nordic-5-Clause
#

menuconfig WATCHDOG_APPLICATION
	bool "Application watchdog"
	select WATCHDOG
	default y

if WATCHDOG_APPLICATION

choice WATCHDOG_APPLICATION_FEED_TYPE
	prompt "Select direct feed or feed request"
	default WATCHDOG_APPLICATION_FEED_WORKQUEUE

config WATCHDOG_APPLICATION_FEED_WORKQUEUE
	bool "Feed watchdog through work queue item"

config WATCHDOG_APPLICATION_FEED_REQUEST
	bool "Request watchdog feed from application"
	help
		Instead of directly feeding the watchdog from the main workqueue,
		issue an event instead and leave the actual watchdog feed
		up to the application.

endchoice

config WATCHDOG_APPLICATION_FEED_DELAY_SEC
	int "Amount of seconds between expected and actual feed"
	default 0 if WATCHDOG_APPLICATION_FEED_WORKQUEUE
	default 60 if WATCHDOG_APPLICATION_FEED_REQUEST
	help
		When using WATCHDOG_APPLICATION_FEED_REQUEST, this is the delay
		in seconds that the watchdog module expects the application to take
		to feed the watchdog.
		The feed request event in this case is issued
		WATCHDOG_APPLICATION_FEED_DELAY_SEC earlier than the regular worker delay.

config WATCHDOG_APPLICATION_TIMEOUT_SEC
	int "Application watchdog timeout in seconds"
	default 600

endif # WATCHDOG_APPLICATION

module = WATCHDOG
module-str = Watchdog
source "subsys/logging/Kconfig.template.log_config"
```

## applications/etc-app/src/modules/Kconfig.app_module
```kconfig
config ETC_APP_LTE_SYNC_NACK_THRESHOLD
	int "Unacknowledged readings above which a LoRa logger also uploads over LTE"
	default 4
	help
	  FW-788. A LoRa logger with strictly more than this many unacknowledged
	  readings at a transmit interval brings up LTE in addition to its normal
	  LoRa attempt. Set very large to disable the behaviour.

config ETC_APP_LTE_SYNC_BACKOFF_MULTIPLE
	int "Minimum spacing between LTE bring-ups, in transmit intervals"
	default 4
	help
	  FW-789 floor. Opportunistic LTE bring-ups are attempted at most once per
	  this many tx intervals (default 4 x 900 s = 1 h).

config ETC_APP_LTE_SYNC_BACKOFF_MAX_S
	int "Ceiling for the exponential LTE backoff, in seconds"
	default 86400
	help
	  FW-789 ceiling. After consecutive failed bring-ups the spacing doubles
	  from the floor but never exceeds this (default once per day).

config ETC_APP_THRESHOLD_MIN_REPORT_INTERVAL_S
	int "Default spacing between threshold-triggered uploads, in seconds"
	range 60 86400
	default 900
	help
	  FW-1179. All immediate report threshold slots share this hold-off: a
	  crossing within this many seconds of the last threshold-triggered upload
	  is still flagged but does not transmit ahead of schedule. Bounds battery
	  and airtime cost when a reading oscillates around a threshold. The window
	  starts when an upload is requested, so a request later dropped by the
	  functional test or a shutdown still consumes it.

	  Default only: the live hold-off is the stored setting the server writes
	  through EXACT Configuration (48931) resource 16.
```

## applications/etc-app/src/modules/Kconfig.lora_module
```kconfig
menuconfig ETC_LORA_MODULE
	bool "Enable/disable LoRa module"
	default y

if ETC_LORA_MODULE

config ETC_LORA_MODULE_RX_FREQUENCY
        int "LoRa frequency used for receives"
        default 915000000

config ETC_LORA_MODULE_TX_FREQUENCY
        int "LoRa frequency used for transmits"
        default 915000000

config ETC_LORA_MODULE_STACK_SIZE
        int "Stack size for Lora thread"
        default 4096

config ETC_LORA_XMESH_PROTOCOL
	bool "Enable EXACT LoRa Mesh v2.1 (Heltec V3) protocol"
	default y
	help
	  When enabled, transmits binary DataPkt frames (matching Heltec WiFi LoRa 32 V3 mesh)
	  using SF9 and LoRaWAN public sync word (0x34), encoding Input 1 (temp) and Input 2 (temp/rh).

endif
```

## applications/etc-app/src/modules/Kconfig.modem_module
```kconfig
#
# Copyright (c) 2023 EXACT Technology
#

menuconfig MODEM_MODULE
	bool "Modem module"
	default y

if MODEM_MODULE

config MODEM_MODULE_MAX_CONNECTION_TIME_S
	int "Maximum allowed modem connection time"
	default 240
	help
	  The maximum amount of time in seconds that the modem is allowed
	  to take from turning on to having established a network connection.
	  If the modem takes longer than this amount of configured time,
	  the modem is turned off manually until the next scheduled transmit or
	  other wakeup event.

config MODEM_MODULE_UNEXPECTED_WAKEUP_TIMEOUT_S
	int "Timeout to shut down modem after unexpected wakeup"
	default 15
	help
	  If the modem has not connected to an LTE network after this timeout
	  after an unexpected wake up, the modem will be turned off.
	  An unexpected wake up is defined as the modem waking up without any
	  user interaction when the modem is not in PSM mode.

config MODEM_MODULE_RELAY_PSM_RAT
	string "Requested PSM active time in relay mode"
	default "00100010"

config MODEM_MODULE_RELAY_PSM_RPTAU
	string "Requested PSM periodic TAU in relay mode, default 2 minutes"
	default "00111000"

config MODEM_MODULE_RELAY_SOFT_PSM_TIMEOUT_S
	int "Requested soft PSM timeout in relay mode"
	default 90

config MODEM_MODULE_SHELL
	bool "Enable the shell with test commands"

config MODEM_MODULE_GNSS_TIMEOUT_S
	int "Timeout to turn off GNSS if no location was found"
	default 60

config MODEM_MODULE_DESIRED_FIX_COUNT
	int "GNSS is turned off and location accepted when this fix count is reached"
	default 3


endif
```
