## CMakeLists.txt
```
cmake_minimum_required(VERSION 3.13.1)

set(CONFIG_APPLICATION_DEFINED_SYSCALL true)
find_package(Zephyr REQUIRED HINTS $ENV{ZEPHYR_BASE})

project(etc-ble)

target_sources(app PRIVATE src/main.c
    src/flex_ble.c
    src/flex_data.c
)
zephyr_cc_option(-Wfatal-errors)

zephyr_include_directories(src)
```

## prj.conf
```kconfig
CONFIG_NEWLIB_LIBC=y
CONFIG_NEWLIB_LIBC_FLOAT_PRINTF=y
CONFIG_ASSERT=y
CONFIG_REBOOT=y
CONFIG_RESET_ON_FATAL_ERROR=n
CONFIG_FPU=y
CONFIG_FW_INFO=y
CONFIG_CJSON_LIB=y

# Disable boot banner. printk outputs get dropped w/ usbcdc
CONFIG_BOOT_BANNER=n
# Heap and stacks
CONFIG_HEAP_MEM_POOL_SIZE=8192
CONFIG_MAIN_STACK_SIZE=8192
CONFIG_SYSTEM_WORKQUEUE_STACK_SIZE=2048

# Log
CONFIG_LOG=y
CONFIG_LOG_BACKEND_UART=y

# Bluetooth
CONFIG_BT=y
CONFIG_BT_DEBUG_LOG=y
CONFIG_BT_PERIPHERAL=y
CONFIG_BT_BROADCASTER=y
CONFIG_BT_DEVICE_APPEARANCE=833
CONFIG_BT_MAX_CONN=1
CONFIG_BT_MAX_PAIRED=1
CONFIG_BT_BAS=y
CONFIG_BT_DIS=y
CONFIG_BT_PRIVACY=y
CONFIG_BT_SMP=y
CONFIG_BT_DEVICE_NAME="Flex"
CONFIG_BT_DEVICE_NAME_DYNAMIC=y
CONFIG_BT_DEVICE_NAME_MAX=65
CONFIG_BT_L2CAP_TX_MTU=256
CONFIG_BT_BUF_ACL_RX_SIZE=502
CONFIG_BT_BUF_ACL_TX_SIZE=502
CONFIG_BT_CTLR_DATA_LENGTH_MAX=251

# Enable setting 
CONFIG_SETTINGS=y
CONFIG_BT_SETTINGS=y
CONFIG_FLASH=y
CONFIG_FLASH_PAGE_LAYOUT=y
CONFIG_FLASH_MAP=y
CONFIG_NVS=y
CONFIG_MPU_ALLOW_FLASH_WRITE=y

# Random subsys
CONFIG_ENTROPY_GENERATOR=y
CONFIG_TEST_RANDOM_GENERATOR=y

# Configuration for Crypto
CONFIG_MBEDTLS=y
CONFIG_MBEDTLS_BUILTIN=y
CONFIG_MBEDTLS_ENABLE_HEAP=y
CONFIG_MBEDTLS_HEAP_SIZE=32700
CONFIG_BASE64=y
```

## boards/etc.conf
```kconfig
# USB
CONFIG_USB_DEVICE_STACK=y
CONFIG_USB_DEVICE_PRODUCT="FlexUSB"
CONFIG_SHELL_BACKEND_SERIAL_CHECK_DTR=y
CONFIG_UART_CONSOLE=y
CONFIG_CONSOLE=y
CONFIG_UART_LINE_CTRL=y
CONFIG_SHELL_LOG_BACKEND=n
CONFIG_USB_CDC_ACM_LOG_LEVEL_OFF=y

# Partition Manager
CONFIG_PM_OVERRIDE_EXTERNAL_DRIVER_CHECK=y
CONFIG_PM_PARTITION_REGION_SETTINGS_STORAGE_EXTERNAL=n
CONFIG_PM_PARTITION_REGION_NVS_STORAGE_EXTERNAL=y

# MCUBOOT
CONFIG_BOOTLOADER_MCUBOOT=y
CONFIG_IMG_MANAGER=y
CONFIG_MCUBOOT_IMG_MANAGER=y
CONFIG_IMG_ERASE_PROGRESSIVELY=y
```

## boards/etc.overlay
```dts
/ {
	chosen {
		nordic,pm-ext-flash = &mx25r1635;
		zephyr,shell-uart = &cdc_acm_uart0;
		zephyr,console = &cdc_acm_uart0;
	};
};

zephyr_udc0: &usbd {
	cdc_acm_uart1 {
		status = "disabled";
	};
};
```

## src/main.c
```c
#include <zephyr/kernel.h>
#include <zephyr/logging/log.h>
#include <zephyr/drivers/uart.h>
#include <zephyr/drivers/gpio.h>
#include <zephyr/usb/usb_device.h>

LOG_MODULE_REGISTER(main, LOG_LEVEL_DBG);

#include "flex_ble.h"

int main(void)
{
#if defined(CONFIG_USB_DEVICE_STACK)
	uint32_t dtr = 0;
	const struct device *dev = DEVICE_DT_GET(DT_CHOSEN(zephyr_shell_uart));
	if (!device_is_ready(dev) || usb_enable(NULL)) {
		return 0;
	}

	while (!dtr) {
		uart_line_ctrl_get(dev, UART_LINE_CTRL_DTR, &dtr);
		k_sleep(K_MSEC(100));
	}
#endif
	LOG_INF("Flex BLE application");
	int rc = etc_ble_init();
	if (rc) {
		LOG_ERR("Failed to initialize the BLE");
		return rc;
	}

	while (1) {
		k_sleep(K_SECONDS(1));
	}
	return 0;
}
```

## src/flex_ble.c
```c
#include <stdio.h>
#include <zephyr/bluetooth/bluetooth.h>
#include <zephyr/bluetooth/conn.h>
#include <zephyr/bluetooth/gatt.h>
#include <zephyr/settings/settings.h>
#include <zephyr/random/random.h>
#define LOG_LEVEL LOG_LEVEL_DBG
#include <zephyr/logging/log.h>
LOG_MODULE_REGISTER(flex_ble);

#define DEVICE_NAME CONFIG_BT_DEVICE_NAME
#define DEVICE_NAME_LEN (sizeof(DEVICE_NAME) - 1)

#define BT_UUID_SERVICE_VAL BT_UUID_128_ENCODE(0x24eb85c0, 0x1114, 0x46fd, 0xa9a3, 0x1559361c6a95)

#define BT_UUID_SENSOR_CHAR_VAL                                                                   \
	BT_UUID_128_ENCODE(0x24eb85c1, 0x1114, 0x46fd, 0xa9a3, 0x1559361c6a95)

#define BT_UUID_RECLAIM_CHAR_VAL                                                                     \
	BT_UUID_128_ENCODE(0x24eb85c2, 0x1114, 0x46fd, 0xa9a3, 0x1559361c6a95)

#define BT_UUID_CONFIG_CHAR_VAL                                                                    \
	BT_UUID_128_ENCODE(0x24eb85c3, 0x1114, 0x46fd, 0xa9a3, 0x1559361c6a95)
	
#define BT_UUID_SERVICE BT_UUID_DECLARE_128(BT_UUID_SERVICE_VAL)
#define BT_UUID_SENSOR_CHAR BT_UUID_DECLARE_128(BT_UUID_SENSOR_CHAR_VAL)
#define BT_UUID_RECLAIM_CHAR BT_UUID_DECLARE_128(BT_UUID_RECLAIM_CHAR_VAL)
#define BT_UUID_CONFIG_CHAR BT_UUID_DECLARE_128(BT_UUID_CONFIG_CHAR_VAL)

static struct k_work advertise_work;
static char flex_device_name[CONFIG_BT_DEVICE_NAME_MAX] = { 0x00 };
static struct bt_conn *current_conn;

static uint8_t adv_data[] = {
	0x00, 0x00, 0x00, 0x00, // Manufacturer 
	0x00, 0x00, 0x00, 0x00, // Probe 1
	0x00, 0x00, 0x00, 0x00, // Probe 2
	0x00, 0x00, 0x00, 0x00, // Probe 3
	0x00, 0x00, 0x00, 0x00, // Probe 4
	0x00, 0x00, 0x00, 0x00, // Humid 
};

static const struct bt_data ad[] = {
	BT_DATA_BYTES(BT_DATA_FLAGS, (BT_LE_AD_GENERAL | BT_LE_AD_NO_BREDR)),
	BT_DATA(BT_DATA_MANUFACTURER_DATA, adv_data, sizeof(adv_data)),
};

static void flex_sensor_ccc_cfg_changed(const struct bt_gatt_attr *attr,
				  uint16_t value)
{
	LOG_DBG("Notification has been turned %s",
		value == BT_GATT_CCC_NOTIFY ? "on" : "off");
}

static void flex_reclaim_ccc_cfg_changed(const struct bt_gatt_attr *attr,
				  uint16_t value)
{
	LOG_DBG("Notification has been turned %s",
		value == BT_GATT_CCC_NOTIFY ? "on" : "off");
}

static void flex_config_ccc_cfg_changed(const struct bt_gatt_attr *attr,
				  uint16_t value)
{
	LOG_DBG("Notification has been turned %s",
		value == BT_GATT_CCC_NOTIFY ? "on" : "off");
}

static void flex_ble_set_bt_name(void)
{
	snprintf(flex_device_name, sizeof(flex_device_name), "Flex_%d", 10000013);
	int err = bt_set_name(flex_device_name);
	if (err) {
		LOG_ERR("Can't set BLE device name");
	}
}

/* Flex Service Declaration */
BT_GATT_SERVICE_DEFINE(flex_svc,
	BT_GATT_PRIMARY_SERVICE(BT_UUID_SERVICE),
	BT_GATT_CHARACTERISTIC(BT_UUID_SENSOR_CHAR, BT_GATT_CHRC_READ | BT_GATT_CHRC_NOTIFY,
			       BT_GATT_PERM_READ_ENCRYPT, NULL,
			       NULL, NULL),
	BT_GATT_CCC(flex_sensor_ccc_cfg_changed, BT_GATT_PERM_READ_ENCRYPT | BT_GATT_PERM_WRITE_ENCRYPT),
	BT_GATT_CHARACTERISTIC(BT_UUID_RECLAIM_CHAR, BT_GATT_CHRC_READ | BT_GATT_CHRC_NOTIFY,
			       BT_GATT_PERM_READ_ENCRYPT, NULL,
			       NULL, NULL),
	BT_GATT_CCC(flex_reclaim_ccc_cfg_changed, BT_GATT_PERM_READ_ENCRYPT | BT_GATT_PERM_WRITE_ENCRYPT),
	BT_GATT_CHARACTERISTIC(BT_UUID_CONFIG_CHAR, BT_GATT_CHRC_READ | BT_GATT_CHRC_NOTIFY | BT_GATT_CHRC_WRITE,
			       BT_GATT_PERM_READ_ENCRYPT | BT_GATT_PERM_WRITE_ENCRYPT, NULL,
			       NULL, NULL),
	BT_GATT_CCC(flex_config_ccc_cfg_changed, BT_GATT_PERM_READ_ENCRYPT | BT_GATT_PERM_WRITE_ENCRYPT)
);

static void flex_ble_sim_data(void) {
	float temp_1 = (float)(sys_rand32_get() % 125);
	float temp_2 = (float)(sys_rand32_get() % 125);
	float temp_3 = (float)(sys_rand32_get() % 125);
	float temp_4 = (float)(sys_rand32_get() % 125);
	float humid = (float)(sys_rand32_get() % 100);
	memcpy(&adv_data[4], &temp_1, sizeof(temp_1));
	memcpy(&adv_data[8], &temp_2, sizeof(temp_2));
	memcpy(&adv_data[12], &temp_3, sizeof(temp_3));
	memcpy(&adv_data[16], &temp_4, sizeof(temp_4));
	memcpy(&adv_data[20], &humid, sizeof(humid));
	LOG_INF("Sim data %2.1f %2.1f %2.1f %2.1f %2.1f", temp_1, temp_2, temp_3, temp_4, humid);
}

static void advertise(struct k_work *work)
{
	int rc;
	/* Generate simulation data */
	flex_ble_sim_data();

	bt_le_adv_stop();

	rc = bt_le_adv_start(BT_LE_ADV_CONN_NAME, ad, ARRAY_SIZE(ad), NULL, 0);
	if (rc) {
		LOG_ERR("Advertising failed to start (rc %d)", rc);
		return;
	}

	LOG_INF("Advertising successfully started");
}

static void connected(struct bt_conn *conn, uint8_t err)
{
	if (err) {
		LOG_ERR("Connection failed (err 0x%02x)", err);
	} else {
		LOG_INF("Connected");
		current_conn = conn;
	}
}

static void disconnected(struct bt_conn *conn, uint8_t reason)
{
	current_conn = NULL;
	LOG_INF("Disconnected (reason 0x%02x)", reason);
	k_work_submit(&advertise_work);
}

#if defined(CONFIG_BT_SMP)
static void security_changed(struct bt_conn *conn, bt_security_t level,
			     enum bt_security_err err)
{
	char addr[BT_ADDR_LE_STR_LEN];

	bt_addr_le_to_str(bt_conn_get_dst(conn), addr, sizeof(addr));

	if (!err) {
		LOG_INF("Security changed: %s level %u", addr, level);
	} else {
		LOG_WRN("Security failed: %s level %u err %d", addr,
			level, err);
		int rc = bt_unpair(BT_ID_DEFAULT, bt_conn_get_dst(conn));
		LOG_DBG("Unpair this connection %d", rc);
	}
}
#endif

BT_CONN_CB_DEFINE(conn_callbacks) = {
	.connected = connected,
	.disconnected = disconnected,
#if defined(CONFIG_BT_SMP)
	.security_changed = security_changed,
#endif
};

static void auth_cancel(struct bt_conn *conn)
{
	char addr[BT_ADDR_LE_STR_LEN];
	bt_addr_le_to_str(bt_conn_get_dst(conn), addr, sizeof(addr));
	LOG_INF("Pairing cancelled: %s", addr);
}

static void pairing_complete(struct bt_conn *conn, bool bonded)
{
	char addr[BT_ADDR_LE_STR_LEN];
	bt_addr_le_to_str(bt_conn_get_dst(conn), addr, sizeof(addr));
	LOG_INF("Pairing completed: %s, bonded: %d", addr, bonded);
}


static void pairing_failed(struct bt_conn *conn, enum bt_security_err reason)
{
	char addr[BT_ADDR_LE_STR_LEN];
	bt_addr_le_to_str(bt_conn_get_dst(conn), addr, sizeof(addr));
	LOG_INF("Pairing failed conn: %s, reason %d", addr, reason);
}

void mtu_updated(struct bt_conn *conn, uint16_t tx, uint16_t rx)
{
	LOG_INF("Updated MTU: TX: %d RX: %d bytes", tx, rx);
}

static struct bt_conn_auth_cb conn_auth_callbacks = {
	.cancel = auth_cancel,
};

static struct bt_conn_auth_info_cb conn_auth_info_callbacks = {
	.pairing_complete = pairing_complete,
	.pairing_failed = pairing_failed
};

static struct bt_gatt_cb gatt_callbacks = {
	.att_mtu_updated = mtu_updated
};

int etc_ble_init(void) {
	k_work_init(&advertise_work, advertise);

	int rc = 0;
	rc = bt_conn_auth_cb_register(&conn_auth_callbacks);
	if (rc) {
		LOG_ERR("Failed to register authorization callbacks");
		return 0;
	}

	rc = bt_conn_auth_info_cb_register(&conn_auth_info_callbacks);
	if (rc) {
		printk("Failed to register authorization info callbacks.");
		return 0;
	}

	bt_gatt_cb_register(&gatt_callbacks);

	/* Enable Bluetooth. */
	rc = bt_enable(NULL);
	if (rc != 0) {
		LOG_ERR("Bluetooth init failed (err %d)", rc);
		return rc;
	}

	if (IS_ENABLED(CONFIG_SETTINGS)) {
		rc = settings_load();
		if (rc) {
			LOG_ERR("settings load failed (err %d)", rc);
			return rc;
		}
	}

	/* Set BLE device name */
	flex_ble_set_bt_name();

	LOG_INF("Bluetooth initialized");
	k_work_submit(&advertise_work);

	return 0;
}
```

## src/flex_ble.h
```c
#ifndef FLEX_BLE_H_
#define FLEX_BLE_H_

#include <stdint.h>

int etc_ble_init(void);

#endif /* FLEX_BLE_H_ */
```

## src/flex_data.c
```c
// /* Format for current measurement */
// {
//     "logger_id" : 10000013,
//     "time": 1687901671,
//     "packet": 1,
//     "ports": {
//         "0": [
//             {
//                 "measurement": 0,
//                 "type": 0,
//                 "unit": "Cel",
//                 "value": 54.2
//             }
//         ],
//         "2": [
//             {
//                 "measurement": 0,
//                 "type": 0,
//                 "unit": "Cel",
//                 "value": 54.2
//             }
//         ],
//         "4": [
//             {
//                 "measurement": 0,
//                 "type": 0,
//                 "unit": "Cel",
//                 "value": 54.2
//             }
//         ]
//     }
// }

// {
//     1: 123,
//     2: 1687891419,
//     3: 1,
//     4: {
//         0: [{
//                     1: 0,
//                     2: 0,
//                     3: "Cel",
//                     4: 54.2
//             }],
//         1: [{
//                     1: 0,
//                     2: 0,
//                     4: 54.2
//                 },
//                 {
//                     1: 1,
//                     2: 1,
//                     3: "%RH",
//                     4: 54.2
//             }],
//         2: [{
//                     1: 0,
//                     2: 0,
//                     4: 54.2
//             }],
//         3: [{
//                     1: 0,
//                     2: 0,
//                     4: 54.2
//             }],
//         4: [{
//                     1: 0,
//                     2: 0,
//                     4: 54.2
//             }]
//     }
// }
```

## src/flex_data.h
```c
#ifndef FLEX_DATA_H_
#define FLEX_DATA_H_

void flex_data_init(void);
void flex_data_current(void);
void flex_data_reclaim(void);

#endif /* FLEX_DATA_H_ */
```
