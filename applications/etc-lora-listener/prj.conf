## CMakeLists.txt
```
cmake_minimum_required(VERSION 3.13.1)

set(CONFIG_APPLICATION_DEFINED_SYSCALL true)
find_package(Zephyr REQUIRED HINTS $ENV{ZEPHYR_BASE})

project(etc_lora_listener)

target_sources(app PRIVATE 
  src/main.c
  src/data/etc_cape.c
  src/lora_listener.c
)
zephyr_cc_option(-Wfatal-errors)

zephyr_include_directories(src)

add_subdirectory(src/data)
```

## Kconfig
```
menu "EXACT LoRa Listener Application"

endmenu

menu "Zephyr Kernel"
source "$ZEPHYR_BASE/Kconfig.zephyr"
endmenu

module = ETC_LORA_LISTENER
module-str = ETC LoRa Listener
source "${ZEPHYR_BASE}/subsys/logging/Kconfig.template.log_config"
```

## prj.conf
```kconfig
# General config
CONFIG_ASSERT=y
CONFIG_REBOOT=y
CONFIG_RESET_ON_FATAL_ERROR=y
CONFIG_FPU=y
CONFIG_FW_INFO=y

# Disable boot banner. printk outputs get dropped w/ usbcdc
CONFIG_BOOT_BANNER=n
# Heap and stacks
CONFIG_HEAP_MEM_POOL_SIZE=4096
CONFIG_MAIN_STACK_SIZE=4096
CONFIG_SYSTEM_WORKQUEUE_STACK_SIZE=2304

CONFIG_LOG=y

# CONFIG_SHELL=y
# CONFIG_SHELL_VT100_COLORS=n
# CONFIG_SHELL_LOG_LEVEL_INF=y
# CONFIG_SHELL_BACKEND_SERIAL=y
# CONFIG_SHELL_BACKEND_SERIAL_INIT_PRIORITY=51
# CONFIG_SHELL_BACKEND_SERIAL_RX_RING_BUFFER_SIZE=128
# CONFIG_SHELL_BACKEND_SERIAL_CHECK_DTR=y

CONFIG_USB_DEVICE_STACK=y
CONFIG_USB_DEVICE_PRODUCT="ETC USB Shell"
CONFIG_USB_CDC_ACM_LOG_LEVEL_INF=y
CONFIG_CONSOLE_SUBSYS=y
CONFIG_CONSOLE_GETCHAR=y
CONFIG_CONSOLE_PUTCHAR_BUFSIZE=512
CONFIG_UART_CONSOLE=y
CONFIG_CONSOLE=y
CONFIG_UART_LINE_CTRL=y

CONFIG_SPI=y
CONFIG_GPIO=y
CONFIG_LORA=y
CONFIG_LORA_SX127X=y
```

## boards/etc_flex_nrf52840.overlay
```dts
/ {
	chosen {
		zephyr,console = &cdc_acm_uart0;
	};
};

zephyr_udc0: &usbd {
	cdc_acm_uart1 {
		status = "disabled";
	};
};
```

## src/main.c
```c
#include <zephyr/kernel.h>
#include <zephyr/logging/log.h>
#include <stdlib.h>
#include <zephyr/console/console.h>
#include <zephyr/drivers/uart.h>
#include <zephyr/drivers/gpio.h>
#include <zephyr/usb/usb_device.h>

#include "data/etc_cape.h"
#include "lora_listener.h"
#include <zephyr/logging/log.h>
LOG_MODULE_REGISTER(main, CONFIG_ETC_LORA_LISTENER_LOG_LEVEL);

BUILD_ASSERT(DT_NODE_HAS_COMPAT(DT_CHOSEN(zephyr_console), zephyr_cdc_acm_uart),
	     "Console device is not ACM CDC UART device");

char key[] = "ElL10TaC4T";

void main(void)
{
	etc_cape_init(key, 10, 0);
	etc_cape_set_key(key, 10);
	uint32_t dtr = 0;
	const struct device *dev = DEVICE_DT_GET(DT_CHOSEN(zephyr_console));
	if (!device_is_ready(dev) || usb_enable(NULL)) {
		return;
	}
	console_init();
	console_write(NULL, "Starting LoRa listener...\r\n", strlen("Starting LoRa listener...\r\n"));

	lora_receive();

	while(1) {
		k_sleep(K_SECONDS(1));
	}
}
```

## src/lora_listener.c
```c
#include <zephyr/kernel.h>
#include <zephyr/console/console.h>
#include <zephyr/drivers/lora.h>
#include "data/etc_cape.h"
#include "lora_listener.h"

#include <zephyr/logging/log.h>
LOG_MODULE_REGISTER(lora, CONFIG_ETC_LORA_LISTENER_LOG_LEVEL);

#define LORA_ACKUNCRYPT_LEN	128
#define LORA_ACKCRYPT_LEN	128

#define CONFIG_ETC_LORA_MODULE_RX_FREQUENCY 915000000

static char decoded_buf[LORA_ACKUNCRYPT_LEN] = {0x00};
static uint8_t lora_rx_buf[LORA_ACKUNCRYPT_LEN] = {0x00};

const struct device *lora_dev = DEVICE_DT_GET(DT_ALIAS(lora0));

static struct lora_modem_config etc_lora_rx_config = {
	.frequency = CONFIG_ETC_LORA_MODULE_RX_FREQUENCY,
	.bandwidth = BW_125_KHZ,
	.datarate = SF_7,
	.preamble_len = 8,
	.coding_rate = CR_4_5,
	.tx_power = 14,
	.tx = false,
};

const char new_line[] = "\r\n";

static bool contains_unprintable_characters(char *data, uint16_t length)
{
	for (uint16_t i = 0; i < length; i++) {
		if (data[i] < 32 || data[i] > 126) {
			return true;
		}
	}
	return false;
}

static void lora_receive_cb(const struct device *dev, uint8_t *data, uint16_t size, int16_t rssi,
			    int8_t snr)
{
	int decoded_len = 0;
	memset(decoded_buf, 0, sizeof(decoded_buf));
	etc_cape_decrypt((char *)data, decoded_buf, size);
	decoded_len = size - 1;
	if (contains_unprintable_characters(decoded_buf, decoded_len)) {
		LOG_HEXDUMP_DBG(data, size, "Raw data");
	} else {
		console_write(NULL, decoded_buf, decoded_len);
		console_write(NULL, new_line, sizeof(new_line) - 1);
	}
}

void lora_receive(void)
{
	int ret = 0;

	memset(lora_rx_buf, 0, sizeof(lora_rx_buf));
	memset(decoded_buf, 0, sizeof(decoded_buf));
	ret = lora_config(lora_dev, &etc_lora_rx_config);
	if (ret < 0) {
		LOG_ERR("Lora_config failed error %d", ret);
		return;
	}

	lora_recv_async(lora_dev, lora_receive_cb);
}
```

## src/lora_listener.h
```c
#ifndef __LORA_LISTENER_H__
#define __LORA_LISTENER_H__

void lora_receive(void);

#endif /* __LORA_LISTENER_H__ */
```
